#include "sdio_sdcard.h"
#include "string.h"	 
#include "sys.h"	 
#include "usart.h"	 
//////////////////////////////////////////////////////////////////////////////////	 

//STM32F407闂傚倸鍊搁崐宄懊归崶褉鏋栭柡鍥ュ灩缁愭鏌熼悧鍫熺凡闁告垹濮撮埞鎴︽偐鐎圭姴顥濈紓浣哄閸ㄥ爼寮婚敐澶婄闁挎繂鎲涢幘缁樼厸闁告侗鍠楅崐鎰版煛瀹€瀣瘈鐎规洘甯掕灒閻炴稈鈧厖澹曢梺鍝勭▉閸嬧偓闁稿鎸搁～婵嬵敆閸屾簽銊╂⒑閸濆嫯顫﹂柛鏃€鍨块獮鍐閵堝懎绐涙繝鐢靛Т鐎氼亞妲愰弴銏♀拻?
//SDIO 闂傚倸鍊搁崐宄懊归崶褉鏋栭柡鍥ュ灩缁愭鏌熼悧鍫熺凡闁告垹濮撮埞鎴︽偐鐎圭姴顥濈紓浣哄閸ㄥ爼寮婚敐澶婄闁挎繂鎲涢幘缁樼厸闁告侗鍠楅崐鎰版煛瀹€瀣瘈鐎规洘甯掕灒閻炴稈鈧厖澹曢梺鍝勭▉閸嬧偓闁稿鎸搁～婵嬵敆閸屾簽銊╂⒑閸濆嫯顫﹂柛鏃€鍨块獮鍐閵堝懎绐涙繝鐢靛Т鐎氼亞妲愰弴銏♀拻濞达絽鎽滅粔鐑樸亜閵夛附宕岀€规洘顨呴～婊堝焵椤掆偓椤曪綁顢曢敃鈧粻濠氭偣閸パ冪骇妞ゃ儲绻堝娲濞戞艾顣哄┑鈽嗗亝椤ㄥ﹪銆?   

////////////////////////////////////////////////////////////////////////////////// 	 

// SDIO driver runtime structures
SDIO_InitTypeDef SDIO_InitStructure;
SDIO_CmdInitTypeDef SDIO_CmdInitStructure;
SDIO_DataInitTypeDef SDIO_DataInitStructure;   

SD_Error CmdError(void);  
SD_Error CmdResp7Error(void);
SD_Error CmdResp6Error(u8 cmd,u16*prca);
SD_Error SDEnWideBus(u8 enx);
SD_Error IsCardProgramming(u8 *pstatus);
SD_Error FindSCR(u16 rca,u32 *pscr);
u8 convert_from_bytes_to_power_of_two(u16 NumberOfBytes);

static u8 CardType=SDIO_STD_CAPACITY_SD_CARD_V1_1;
static u32 CSD_Tab[4],CID_Tab[4],RCA=0;
static u8 DeviceMode=SD_DMA_MODE;
static u8 StopCondition=0;
volatile SD_Error TransferError=SD_OK;
volatile u8 TransferEnd=0;
SD_CardInfo SDCardInfo;
__align(4) u8 SDIO_DATA_BUFFER[512];

SD_Error CmdResp1Error(u8 cmd)
{
	u32 status;
	u32 timeout=SDIO_CMD0TIMEOUT;
	while(timeout--)
	{
		status=SDIO->STA;
		if(status&((1<<0)|(1<<2)|(1<<6)))break;//CRC闂備焦瀵ч悷銊╊敋?闂佸憡绋掗崹婵嬪箮閵堝浼犵€广儱鎳愮€瑰鎮洪幒鎴炲櫤婵?閻庤鐡曠亸娆戝垝閿熺姴缁╅悹鍝勬惈閻撳倿鏌涘┑鍡櫺㈢紒?CRC闂佸搫绋勭换婵嬫偘濞嗘挸绠ｉ柟閭﹀墮椤?
	}
	if(timeout==0U)
	{
		SDIO_ClearFlag(SDIO_STATIC_FLAGS);
		return SD_CMD_RSP_TIMEOUT;
	}
	if(SDIO_GetFlagStatus(SDIO_FLAG_CTIMEOUT) != RESET)
	{
		SDIO_ClearFlag(SDIO_FLAG_CTIMEOUT);
		return SD_CMD_RSP_TIMEOUT;
	}
	if(SDIO_GetFlagStatus(SDIO_FLAG_CCRCFAIL) != RESET)
	{
		SDIO_ClearFlag(SDIO_FLAG_CCRCFAIL);
		return SD_CMD_CRC_FAIL;
	}
	if(SDIO->RESPCMD!=cmd)return SD_ILLEGAL_CMD;
	SDIO_ClearFlag(SDIO_STATIC_FLAGS);
	return (SD_Error)(SDIO->RESP1&SD_OCR_ERRORBITS);
}
//闂傚倸鍊搁崐宄懊归崶褉鏋栭柡鍥ュ灩缁愭鏌熼悧鍫熺凡闁告垹濮撮埞鎴︽偐鐎圭姴顥濈紓浣哄閸ㄥ爼寮婚敐澶婄闁挎繂鎲涢幘缁樼厸闁告侗鍘介幉鍝ョ磼鏉堛劌绗氭繛鐓庣箻閸╋繝宕橀埞顑锯偓?闂傚倸鍊搁崐宄懊归崶褉鏋栭柡鍥ュ灩缁愭鏌熼悧鍫熺凡闁告垹濮撮埞鎴︽偐鐎圭姴顥濈紓浣哄閸ㄨ泛顫忓ú顏勫瀭妞ゆ洖鎳庨崜浼存⒑閹惰姤鏁辨俊顐㈠暙椤繘鎼圭憴鍕／闂侀潧顭堥崕鏌ユ倵妤ｅ啯鈷戦柛婵嗗閸庡繑銇勯鐘插幋闁绘侗鍠涚粻娑㈠籍閹寸倫褔鏌熼懖鈺勊夐悗娈垮墴閺佸啴宕掑☉姘箥?
//闂傚倸鍊搁崐宄懊归崶褉鏋栭柡鍥ュ灩缁愭鏌熼悧鍫熺凡闁告垹濮撮埞鎴︽偐鐎圭姴顥濈紓浣哄閸ㄥ爼寮婚敐澶婄闁挎繂鎲涢幘缁樼厸闁告侗鍠楅崐鎰版煛瀹€瀣瘈鐎规洘甯掕灒閻炴稈鈧厖澹曢梺鍝勭▉閸嬧偓闁稿鎸搁～婵嬵敆閸屾簽銊╂倵?sd闂傚倸鍊搁崐宄懊归崶褉鏋栭柡鍥ュ灩缁愭鏌熼悧鍫熺凡闁告垹濮撮埞鎴︽偐鐎圭姴顥濈紓浣哄閸ㄥ爼寮婚敐澶婄闁挎繂鎲涢幘缁樼厸闁告侗鍠楅崐鎰版煛瀹€瀣瘈鐎规洘甯掕灒閻炴稈鈧厖澹曢梺鍝勭▉閸嬧偓闁稿鎸搁～婵嬵敆閸屾簽銊╂⒑閸濆嫯顫﹂柛鏃€鍨块獮鍐閵堝懎绐涙繝鐢靛Т鐎氼亞妲愰弴銏♀拻濞达絽鎽滅粔鐑樸亜閵夛附宕岀€规洘顨呴～婊堝焵椤掆偓椤曪綁顢曢敃鈧粻濠氭偣閸パ冪骇妞ゃ儲绻堝娲濞戞艾顣哄┑鈽嗗亝椤ㄥ﹪銆?
SD_Error CmdError(void)
{
	SD_Error errorstatus = SD_OK;
	u32 timeout=SDIO_CMD0TIMEOUT;	   
	while(timeout--)
	{
		if(SDIO_GetFlagStatus(SDIO_FLAG_CMDSENT) != RESET)break;	//闂傚倸鍊搁崐宄懊归崶褉鏋栭柡鍥ュ灩缁愭鏌熼悧鍫熺凡闁告垹濮撮埞鎴︽偐鐎圭姴顥濈紓浣哄閸ㄥ爼寮婚敐澶婄闁挎繂鎲涢幘缁樼厸闁告侗鍠楅崐鎰版煛瀹€瀣瘈鐎规洘甯掕灒閻炴稈鈧厖澹曢梺鍝勭▉閸嬧偓闁稿鎸搁～婵嬵敆閸屾簽銊╂⒑閸濆嫯顫﹂柛鏃€鍨块獮鍐閵堝棙鍎梺鑽ゅ枑濠㈡﹢骞嗛悙鐑樷拻濞达絽鎲￠崯鐐烘煕椤垵鐏︾€规洘鍔欏浠嬵敃閻旇渹澹曞┑顔斤供閸撴稓绮斿ú顏呯厸閻忕偠顕ф慨鍌炴煙椤斿搫鐏茬€规洏鍔嶇换婵嬪礋椤忓棛锛熼梻?闂傚倸鍊搁崐宄懊归崶褉鏋栭柡鍥ュ灩缁愭鏌熼悧鍫熺凡闁告垹濮撮埞鎴︽偐鐎圭姴顥濈紓浣哄閸ㄥ爼寮婚敐澶婄闁挎繂鎲涢幘缁樼厸闁告侗鍠楅崐鎰版煛瀹€瀣瘈鐎规洘甯掕灒閻炴稈鈧厖澹曢梺鍝勭▉閸嬧偓闁稿鎸搁～婵嬵敆閸屾簽銊╂⒑閸濆嫯顫﹂柛鏃€鍨块獮鍐閵堝懎绐涙繝鐢靛Т鐎氼亞妲愰弴銏♀拻濞达絿鍎ら崵鈧梺鎼炲灪閻撯€崇暦閺屻儲鍤戞い鎺戝暙灏?	 
	}	    
	if(timeout==0)return SD_CMD_RSP_TIMEOUT;  
	SDIO_ClearFlag(SDIO_STATIC_FLAGS);//闂傚倸鍊搁崐宄懊归崶褉鏋栭柡鍥ュ灩缁愭鏌熼悧鍫熺凡闁告垹濮撮埞鎴︽偐鐎圭姴顥濈紓浣哄閸ㄥ爼寮婚敐澶婄闁挎繂鎲涢幘缁樼厸闁告侗鍠楅崐鎰版煛瀹€瀣瘈鐎规洘甯掕灒閻炴稈鈧厖澹曢梺鍝勭▉閸嬧偓闁稿鎸搁～婵嬵敆閸屾簽銊╂⒑閸濆嫯顫﹂柛鏃€鍨块獮鍐閵堝懎绐涙繝鐢靛Т鐎氼亞妲愰弴銏♀拻濞达絽鎲＄拹锟犳煕韫囨棑鑰跨€殿喓鍔戦弻鍡楊吋閸涱厼娈ら梻浣稿暱閹碱偊骞婅箛娑欏亗闁靛鏅滈悡鐔兼煛閸屾稑顕滈柛鐔哄仱閺岋綀绠涢敐鍛彎闂?
	return errorstatus;
}	 
//闂傚倸鍊搁崐宄懊归崶褉鏋栭柡鍥ュ灩缁愭鏌熼悧鍫熺凡闁告垹濮撮埞鎴︽偐鐎圭姴顥濈紓浣哄閸ㄥ爼寮婚敐澶婄闁挎繂鎲涢幘缁樼厸闁告侗鍘介幉鍝ョ磼?闂傚倸鍊搁崐宄懊归崶褉鏋栭柡鍥ュ灩缁愭鏌熼悧鍫熺凡闁告垹濮撮埞鎴︽偐鐎圭姴顥濈紓浣哄閸ㄦ娊鍩€椤掑倹鍤€閻庢凹鍘界粩鐔煎幢濞嗗苯浜鹃柣鐔煎亰濡偓濠殿喖锕ㄥ▍锝夊箲閸曨垰惟闁靛濡囬埀顒佹そ濮婃椽鎳栭埡浣镐粯闁诲孩绋堥弲娑⑩€﹂崶顏嗙杸婵炴垶鐟ラ埀顒勬敱閵囧嫰骞掗崱妞惧婵＄偑鍊曠换鎰版偉閻撳寒娼栭柧蹇氼潐瀹曞鏌曟繛鍨姕闁诲酣绠栧娲传閸曢潧鍓板銈庡幘閸忔﹢鎮伴璺ㄧ杸闁哄啯鍨舵晥闂佺鍋愮悰銉р偓娈垮墴閺佸啴宕掑☉姘箥?
//闂傚倸鍊搁崐宄懊归崶褉鏋栭柡鍥ュ灩缁愭鏌熼悧鍫熺凡闁告垹濮撮埞鎴︽偐鐎圭姴顥濈紓浣哄閸ㄥ爼寮婚敐澶婄闁挎繂鎲涢幘缁樼厸闁告侗鍠楅崐鎰版煛瀹€瀣瘈鐎规洘甯掕灒閻炴稈鈧厖澹曢梺鍝勭▉閸嬧偓闁稿鎸搁～婵嬵敆閸屾簽銊╂倵?sd闂傚倸鍊搁崐宄懊归崶褉鏋栭柡鍥ュ灩缁愭鏌熼悧鍫熺凡闁告垹濮撮埞鎴︽偐鐎圭姴顥濈紓浣哄閸ㄥ爼寮婚敐澶婄闁挎繂鎲涢幘缁樼厸闁告侗鍠楅崐鎰版煛瀹€瀣瘈鐎规洘甯掕灒閻炴稈鈧厖澹曢梺鍝勭▉閸嬧偓闁稿鎸搁～婵嬵敆閸屾簽銊╂⒑閸濆嫯顫﹂柛鏃€鍨块獮鍐閵堝懎绐涙繝鐢靛Т鐎氼亞妲愰弴銏♀拻濞达絽鎽滅粔鐑樸亜閵夛附宕岀€规洘顨呴～婊堝焵椤掆偓椤曪綁顢曢敃鈧粻濠氭偣閸パ冪骇妞ゃ儲绻堝娲濞戞艾顣哄┑鈽嗗亝椤ㄥ﹪銆?
SD_Error CmdResp7Error(void)
{
	SD_Error errorstatus=SD_OK;
	u32 status;
	u32 timeout=SDIO_CMD0TIMEOUT;
 	while(timeout--)
	{
		status=SDIO->STA;
		if(status&((1<<0)|(1<<2)|(1<<6)))break;//CRC闂傚倸鍊搁崐宄懊归崶褉鏋栭柡鍥ュ灩缁愭鏌熼悧鍫熺凡闁告垹濮撮埞鎴︽偐鐎圭姴顥濈紓浣哄閸ㄥ爼寮婚敐澶婄闁挎繂鎲涢幘缁樼厸闁告侗鍠楅崐鎰版煛瀹€瀣瘈鐎规洘甯掕灒閻炴稈鈧厖澹曢梺鍝勭▉閸嬧偓闁?闂傚倸鍊搁崐宄懊归崶褉鏋栭柡鍥ュ灩缁愭鏌熼悧鍫熺凡闁告垹濮撮埞鎴︽偐鐎圭姴顥濈紓浣哄閸ㄥ爼寮婚敐澶婄闁挎繂鎲涢幘缁樼厸闁告侗鍠楅崐鎰版煛瀹€瀣瘈鐎规洘甯掕灒閻炴稈鈧厖澹曢梺鍝勭▉閸嬧偓闁稿鎸搁～婵嬵敆閸屾簽銊╂⒑閸濆嫯顫﹂柛鏃€鍨块獮鍐閵堝懎绐涙繝鐢靛Т鐎氼亞妲愰弴銏♀拻濞达絿鍎ら崵鈧梺鎼炲灪閻撯€崇暦閺屻儲鍤戞い鎺戝暙灏忛梻浣告惈鐞氼偊宕曢弻銉﹀亗闁靛鏅滈悡鐔兼煛閸屾稑顕滈柛鐔哄仱閺岋綀绠涢敐鍛彎闂佸搫鐬奸崰鏍箖濠婂牊鍤嶉柕澶涢檮濞堝憡绻?闂傚倸鍊搁崐宄懊归崶褉鏋栭柡鍥ュ灩缁愭鏌熼崜褏甯涢柛瀣耿閺屾洟宕煎┑鎰︾紓浣哄Т椤兘寮诲☉妯锋闁告鍋為悘鍫濐渻閵堝懐绠伴柣鏍帶椤繘鎼圭憴鍕／闂侀潧顭堥崕鏌ユ倶娴ｈ櫣纾兼俊銈勭閻忊晠鏌ｉ妷顔婚偗鐎殿喛娉涢埢搴ㄦ倷椤戭値鍥ㄧ厽閹兼番鍨兼竟妯肩磽瀹ュ拑韬€殿喖顭锋俊鎼佸煛閸屾矮绨婚梻浣告啞缁嬫垿鏁冮敂钘夘嚤闁告洦鍨遍埛鎴︽煟閻斿憡绶叉俊鎻掝煼閺屾盯濮€閿濆懐姣㈤梺?CRC闂傚倸鍊风粈渚€骞栭銈囩煓闁告洦鍘藉畷鍙夌節闂堟侗鍎忛柡瀣╃窔閺岀喖骞戦幇闈涙濠碘槅鍋呴敃銏ゅ蓟閺囥垹閱囨繝闈涙祩濡偛顪冮妶鍛闁绘牕銈稿濠氭晸閻樻彃绐涘銈嗘煥閸氬鎷犻悙鐑樷拺?	
	}
 	if((timeout==0)||(status&(1<<2)))	//闂傚倸鍊搁崐宄懊归崶褉鏋栭柡鍥ュ灩缁愭鏌熼悧鍫熺凡闁告垹濮撮埞鎴︽偐鐎圭姴顥濈紓浣哄閸ㄦ娊鍩€椤掑倹鍤€閻庢凹鍘界粩鐔煎幢濞嗗苯浜鹃柣鐔煎亰濡偓濠殿喖锕ㄥ▍锝夊箲閸曨垰惟闁靛濡囬埀顒勭畺濮婃椽宕崟闈涘壈濡炪値鍘鹃崗姗€鎮伴璺ㄧ杸婵炴垶鐟ч崣鍡涙煟鎼搭垳绉甸柛瀣笒鍗?
	{																				    
		errorstatus=SD_CMD_RSP_TIMEOUT;	//闂傚倸鍊搁崐宄懊归崶褉鏋栭柡鍥ュ灩缁愭鏌熼悧鍫熺凡闁告垹濮撮埞鎴︽偐鐎圭姴顥濈紓浣哄閸ㄦ娊鍩€椤掑倹鍤€閻庢凹鍘奸…鍨潨閳ь剝鐭鹃梺鍛婄☉閻°劑鍩涢幋锔藉仯闁诡厽甯掓俊濂告煛鐎ｎ偄鐏撮柡宀嬬磿閳ь剨缍嗘禍鍫曟偂閸忕⒈娈介柣鎰皺缁犲鏌熼鐣岀煉闁瑰磭鍋ゆ俊鐑芥晜缁涘鎴烽梻鍌氬€风粈渚€骞栭锕€纾归柛顐ｆ礀绾惧綊鏌″搴′簮闁稿鎸搁～婵嬵敆閸屾簽銊╂⒑閸濆嫯顫﹂柛鏃€鍨块獮鍐閵堝懎绐涙繝鐢靛Т鐎氼亞妲愰弴銏♀拻?.0闂傚倸鍊搁崐宄懊归崶褉鏋栭柡鍥ュ灩缁愭鏌熼悧鍫熺凡闁告垹濮撮埞鎴︽偐鐎圭姴顥濈紓浣哄閸ㄥ爼寮婚敐澶婄闁挎繂鎲涢幘缁樼厸闁告侗鍠楅崐鎰版煛瀹€鈧崰鏍箖閻戣棄绾ч柟绋垮珐閳哄懏鐓熼煫鍥ㄦ尵缁犱即鏌熼搹顐€块柣?闂傚倸鍊搁崐宄懊归崶褉鏋栭柡鍥ュ灩缁愭鏌熼悧鍫熺凡闁告垹濮撮埞鎴︽偐鐎圭姴顥濈紓浣哄閸ㄥ爼寮婚敐澶婄闁挎繂鎲涢幘缁樼厸闁告侗鍘介幉鍝ョ磼鏉堛劌娴€殿噮鍣ｉ獮瀣攽閸℃瑥鎽嬪┑锛勫亼閸婃牕煤濡厧鍨濋柟鎹愬吹瀹撲線鐓崶銊р姇闁绘挶鍎甸幃妤呮晲鎼粹€茬凹濠电偛鐗呴崡鍐差潖缂佹ɑ濯撮柤鎭掑劤閵嗗﹪姊洪崫銉バｉ柛鏃€鐟ラ锝夊川婵犲嫮鐦堝┑顔斤供閸撴盯顢欓崱娑欌拺缂備焦锚閻忓崬鈹戦鍝勨偓婵嗩嚕閺屻儱绠瑰ù锝呮贡閸樿鲸绻濋悽闈浶㈤悗姘煎墴瀵憡鎯旈妸锔惧幗闂佹寧绻傞ˇ閬嶆偩濞差亝鐓涢悘鐐额嚙婵倿鏌熼鍝勭伈妤犵偛妫濆璺衡枎閹勭杺缂傚倸鍊烽懗鍫曞磻閹炬剚鐔嗘慨妞诲亾閽樻繈鏌熷▓鍨灀闁稿鎸搁～婵嬵敆閸屾簽銊╂倵鐟欏嫭纾搁柛銊ヮ煼閸┾偓妞ゆ帒锕︾粔鐢告煕閻樻剚娈滅€殿喗鐓￠獮鏍ㄦ媴閸︻厼骞愰梻浣侯焾閺堫剟鏁嬮梺閫炲苯澧柣妤佺矒閸┾偓妞ゆ帊娴囨竟妯肩磽瀹ュ拑宸ラ柣?
		SDIO_ClearFlag(SDIO_FLAG_CTIMEOUT); 			//闂傚倸鍊搁崐宄懊归崶褉鏋栭柡鍥ュ灩缁愭鏌熼悧鍫熺凡闁告垹濮撮埞鎴︽偐鐎圭姴顥濈紓浣哄閸ㄥ爼寮婚敐澶婄闁挎繂鎲涢幘缁樼厸闁告侗鍠楅崐鎰版煛瀹€瀣瘈鐎规洘甯掕灒閻炴稈鈧厖澹曢梺鍝勭▉閸嬧偓闁稿鎸搁～婵嬵敆閸屾簽銊╂⒑閸濆嫯顫﹂柛鏃€鍨块獮鍐閵堝懎绐涙繝鐢靛Т鐎氼亞妲愰弴銏♀拻濞达絽鎽滅粔鐑樸亜閵夛附宕岀€规洘顨呴～婊堝焵椤掆偓椤曪綁顢曢敃鈧粻濠氭偣閸パ冪骇妞ゃ儲绻堝娲濞戞艾顣哄┑鈽嗗亝椤ㄥ﹪銆侀弮鍫濋唶闁哄洨鍟块幏娲煟閻樺厖鑸柛鏂跨焸瀵悂骞嬮敂钘変缓濡炪倖鐗楃粙鎺斾焊閿曞倹鐓涘ù锝囶焾閳ь剙鐏濋悾宄拔旈崨顔间簵闁瑰吋鎯岄崰鏇犳閿曞倹鈷掗柛灞剧懄缁佺増绻涙径瀣鐎规洑鍗抽獮妯兼崉閸濆嫮浜伴梻浣哥秺濡法绮堟担铏逛笉闁绘柨鍚嬮崐鐢告煥濠靛棝顎楀ù婊勭矋閵囧嫯绠涢幘璺虹厽濠殿喖锕ㄥ▍锝夊箲閸曨垰惟闁靛濡囨禍鐐翠繆?
		return errorstatus;
	}	 
	if(status&1<<6)						//闂傚倸鍊搁崐宄懊归崶褉鏋栭柡鍥ュ灩缁愭鏌熼幑鎰靛殭缁绢厸鍋撻梻浣筋潐閸庡吋鎱ㄩ妶澶婄？鐎光偓閸曨剛鍘卞┑鐐村灦閿曨偄顔忛妷锔轰簻闊洦鎸鹃崺锝嗘叏婵犲懏顏犻柟鐟板婵℃悂濡烽敂閿亾妤ｅ啯鈷戦柛婵嗗閸庡繑銇勯鐘插幋闁绘侗鍠涚粻娑樷槈濞嗗繆鍋撴繝姘厾闁诡厽甯掗崝婊勭箾閸涱偄鐏紒杈ㄦ尰閹峰懘宕滈崣澹箓姊虹涵鍛撶紒顔芥崌婵℃挳宕掗悜鍡樻櫔闂侀€炲苯澧撮柣娑卞枦缁犳稑鈽夊▎蹇婂亾婵犳碍鐓犻柟顓熷笒閸旀粍绻涢崨顐㈢伈婵﹥妞藉畷顐﹀礋椤愮喎浜鹃柛顐ｆ礀绾惧綊鏌″搴′簮闁稿鎸搁～婵嬪箛娴ｅ湱绉烽梻?
	{								   
		errorstatus=SD_OK;
		SDIO_ClearFlag(SDIO_FLAG_CMDREND); 				//闂傚倸鍊搁崐宄懊归崶褉鏋栭柡鍥ュ灩缁愭鏌熼悧鍫熺凡闁告垹濮撮埞鎴︽偐鐎圭姴顥濈紓浣哄閸ㄥ爼寮婚敐澶婄闁挎繂鎲涢幘缁樼厸闁告侗鍠楅崐鎰版煛瀹€瀣瘈鐎规洘甯掕灒閻炴稈鈧厖澹曢梺鍝勭▉閸嬧偓闁稿鎸搁～婵嬵敆閸屾簽銊╂⒑閸濆嫯顫﹂柛鏃€鍨块獮鍐閵忋垻鐓撻梺鍓茬厛閸ｎ喖危婵犳碍鈷掑ù锝囨嚀椤曟粓鏌＄仦璇插鐎规洏鍎抽埀顒婄秵閸忔﹢宕戦幘鎰佹僵妞ゆ帒鍊绘闂備礁鎼悮顐﹀礉閹达箑绠栭柕蹇曞Υ閾忓湱纾兼俊顖滅帛閻?
 	}
	return errorstatus;
}	   
//闂傚倸鍊搁崐宄懊归崶褉鏋栭柡鍥ュ灩缁愭鏌熼悧鍫熺凡闁告垹濮撮埞鎴︽偐鐎圭姴顥濈紓浣哄閸ㄥ爼寮婚敐澶婄闁挎繂鎲涢幘缁樼厸闁告侗鍘介幉鍝ョ磼?闂傚倸鍊搁崐宄懊归崶褉鏋栭柡鍥ュ灩缁愭鏌熼悧鍫熺凡闁告垹濮撮埞鎴︽偐鐎圭姴顥濈紓浣哄閸ㄦ娊鍩€椤掑倹鍤€閻庢凹鍘界粩鐔煎幢濞嗗苯浜鹃柣鐔煎亰濡偓濠殿喖锕ㄥ▍锝夊箲閸曨垰惟闁靛濡囬埀顒佹そ濮婃椽鎳栭埡浣镐粯闁诲孩绋堥弲娑⑩€﹂崶顏嗙杸婵炴垶鐟ラ埀顒勬敱閵囧嫰骞掗崱妞惧婵＄偑鍊曠换鎰版偉閻撳寒娼栭柧蹇氼潐瀹曞鏌曟繛鍨姕闁诲酣绠栧娲传閸曢潧鍓板銈庡幘閸忔﹢鎮伴璺ㄧ杸闁哄啯鍨舵晥闂佺鍋愮悰銉р偓娈垮墴閺佸啴宕掑☉姘箥?
//cmd:闂傚倸鍊搁崐宄懊归崶褉鏋栭柡鍥ュ灩缁愭鏌熼悧鍫熺凡闁告垹濮撮埞鎴︽偐鐎圭姴顥濈紓浣哄閸ㄦ娊鍩€椤掑倹鍤€閻庢凹鍘奸…鍨潨閳ь剝鐭鹃梺鍛婄☉閻°劑鍩涢幋锔藉仯闁诡厽甯掓俊濂告煛鐎ｎ偄鐏撮柡宀嬬磿閳ь剨缍嗘禍鍫曟偂閸忕⒈娈介柣鎰皺缁犲鏌熼鐣岀煉闁瑰磭鍋ゆ俊鐑芥晜缁涘鎴烽梻鍌氬€风粈渚€骞栭锕€纾归柛顐ｆ礀绾惧綊鏌″搴′簮闁?
//闂傚倸鍊搁崐宄懊归崶褉鏋栭柡鍥ュ灩缁愭鏌熼悧鍫熺凡闁告垹濮撮埞鎴︽偐鐎圭姴顥濈紓浣哄閸ㄥ爼寮婚敐澶婄闁挎繂鎲涢幘缁樼厸闁告侗鍠楅崐鎰版煛瀹€瀣瘈鐎规洘甯掕灒閻炴稈鈧厖澹曢梺鍝勭▉閸嬧偓闁稿鎸搁～婵嬵敆閸屾簽銊╂倵?sd闂傚倸鍊搁崐宄懊归崶褉鏋栭柡鍥ュ灩缁愭鏌熼悧鍫熺凡闁告垹濮撮埞鎴︽偐鐎圭姴顥濈紓浣哄閸ㄥ爼寮婚敐澶婄闁挎繂鎲涢幘缁樼厸闁告侗鍠楅崐鎰版煛瀹€瀣瘈鐎规洘甯掕灒閻炴稈鈧厖澹曢梺鍝勭▉閸嬧偓闁稿鎸搁～婵嬵敆閸屾簽銊╂⒑閸濆嫯顫﹂柛鏃€鍨块獮鍐閵堝懎绐涙繝鐢靛Т鐎氼亞妲愰弴銏♀拻濞达絽鎽滅粔鐑樸亜閵夛附宕岀€规洘顨呴～婊堝焵椤掆偓椤曪綁顢曢敃鈧粻濠氭偣閸パ冪骇妞ゃ儲绻堝娲濞戞艾顣哄┑鈽嗗亝椤ㄥ﹪銆?
SD_Error CmdResp3Error(void)
{
	u32 status;
	u32 timeout=SDIO_CMD0TIMEOUT;
	while(timeout--)
	{
		status=SDIO->STA;
		if(status&((1<<0)|(1<<2)|(1<<6)))break;//CRC闂傚倸鍊烽悞锔锯偓绗涘洦鍋￠柕濞炬櫓閺?闂傚倷绀侀幉锛勭矙閹烘鍨傛繝闈涱儏缁狀噣鏌曢崼婵愭Ц濞磋偐濮烽埀顒€绠嶉崕閬嶅箠閹邦喒鍋撻悷閭︽█闁诡喗妞介獮鎺楀箣閻愬弶顏℃繝?闂佽姘﹂～澶愭偤閺囩姳鐒婃繛鍡樺灥閸ㄦ繈鏌ㄩ悢鍝勑㈢紓浣叉櫊閹綊宕崟顒佸創闂佺粯鎸搁崐鍧楀蓟濞戞ǚ鏀介柛鈩冾伔閵忋垻纾?CRC闂傚倷绀侀幖顐ょ矙閸曨厽宕叉繝闈涱儐閸嬫ɑ绻涢崱妯诲碍缂佺媴缍侀弻鐔兼焽閿曗偓婢ь喗銇?
	}
	if(timeout==0U)
	{
		SDIO_ClearFlag(SDIO_STATIC_FLAGS);
		return SD_CMD_RSP_TIMEOUT;
	}
	if(SDIO_GetFlagStatus(SDIO_FLAG_CTIMEOUT) != RESET)
	{
		SDIO_ClearFlag(SDIO_FLAG_CTIMEOUT);
		return SD_CMD_RSP_TIMEOUT;
	}
	SDIO_ClearFlag(SDIO_STATIC_FLAGS);
	return SD_OK;
}
//闂傚倸鍊搁崐宄懊归崶褉鏋栭柡鍥ュ灩缁愭鏌熼悧鍫熺凡闁告垹濮撮埞鎴︽偐鐎圭姴顥濈紓浣哄閸ㄥ爼寮婚敐澶婄闁挎繂鎲涢幘缁樼厸闁告侗鍘介幉鍝ョ磼?闂傚倸鍊搁崐宄懊归崶褉鏋栭柡鍥ュ灩缁愭鏌熼悧鍫熺凡闁告垹濮撮埞鎴︽偐鐎圭姴顥濈紓浣哄閸ㄦ娊鍩€椤掑倹鍤€閻庢凹鍘界粩鐔煎幢濞嗗苯浜鹃柣鐔煎亰濡偓濠殿喖锕ㄥ▍锝夊箲閸曨垰惟闁靛濡囬埀顒佹そ濮婃椽鎳栭埡浣镐粯闁诲孩绋堥弲娑⑩€﹂崶顏嗙杸婵炴垶鐟ラ埀顒勬敱閵囧嫰骞掗崱妞惧婵＄偑鍊曠换鎰版偉閻撳寒娼栭柧蹇氼潐瀹曞鏌曟繛鍨姕闁诲酣绠栧娲传閸曢潧鍓板銈庡幘閸忔﹢鎮伴璺ㄧ杸闁哄啯鍨舵晥闂佺鍋愮悰銉р偓娈垮墴閺佸啴宕掑☉姘箥?
//cmd:濠电姷鏁搁崑鐐哄垂閸洖钃熼柕濞炬櫓閺佸嫰鏌涘☉鍗炴灍婵炲懐濞€閺岋絽螣閼测晛绗￠梺缁樻尪閸庣敻寮婚敐澶婃闁圭楠搁弳鍫ユ⒑鐠囧弶绂嬮柛锝忕秮瀵鎮㈤崜鍙壭ч柟鑲╄ˉ閳ь剙鍟跨粻锝夋⒒娴ｈ姤銆冮柣鎺炵畵楠炴垿宕堕鈧拑鐔封攽閻樺弶澶勯柛瀣ㄥ妽缁绘盯宕奸悢濂夊殝濠电偛鐗呴崡鍐差潖妤﹁￥浜归柟鐑樼箖椤ユ牠姊虹粙璺ㄧ闁挎洏鍨归锝夘敃閿曗偓缁犲鎮归崶褍绾фい銉︾箞濮婃椽妫冨☉姘暫濠碘槅鍋呴〃濠囥€侀弮鍫濋唶闁哄洨鍟块幏娲煟閻樺厖鑸柛鏂跨焸瀵悂骞嬮敂鐣屽幐闁诲函缍嗘禍鍫曟偂閸忕⒈娈?
//prca:闂傚倸鍊搁崐宄懊归崶褉鏋栭柡鍥ュ灩缁愭鏌熼悧鍫熺凡闁告垹濮撮埞鎴︽偐鐎圭姴顥濈紓浣哄閸ㄥ爼寮婚敐澶婄闁挎繂鎲涢幘缁樼厸闁告侗鍠楅崐鎰版煛瀹€瀣瘈鐎规洘甯掕灒閻炴稈鈧厖澹曢梺鍝勭▉閸嬧偓闁稿鎸搁～婵嬵敆閸屾簽銊╂⒑閸濆嫯顫﹂柛鏃€鍨块獮鍐閵忋垻鐓撻柣鐘充航閸斿本鎱ㄦ搴ｇ＝濞达絽鎼禍鐐節閵忊槄鑰块挊婵嬫煙濞堝灝鏋撻柛瀣尭椤繃娼忛埡鍌涘晱CA闂傚倸鍊搁崐宄懊归崶褉鏋栭柡鍥ュ灩缁愭鏌熼悧鍫熺凡闁告垹濮撮埞鎴︽偐鐎圭姴顥濈紓浣哄閸ㄦ娊鍩€椤掑倹鍤€閻庢凹鍠楅弲璺何旈崘銊х瓘?
//闂傚倸鍊搁崐宄懊归崶褉鏋栭柡鍥ュ灩缁愭鏌熼悧鍫熺凡闁告垹濮撮埞鎴︽偐鐎圭姴顥濈紓浣哄閸ㄥ爼寮婚敐澶婄闁挎繂鎲涢幘缁樼厸闁告侗鍠楅崐鎰版煛瀹€瀣瘈鐎规洘甯掕灒閻炴稈鈧厖澹曢梺鍝勭▉閸嬧偓闁稿鎸搁～婵嬵敆閸屾簽銊╂倵?闂傚倸鍊搁崐宄懊归崶褉鏋栭柡鍥ュ灩缁愭鏌熼悧鍫熺凡闁告垹濮撮埞鎴︽偐鐎圭姴顥濈紓浣哄閸ㄥ爼寮婚敐澶婄闁挎繂鎲涢幘缁樼厸闁告侗鍠楅崐鎰版煛瀹€瀣瘈鐎规洘甯掕灒閻炴稈鈧厖澹曢梺鍝勭▉閸嬧偓闁稿鎸搁～婵嬵敆閸屾簽銊╂⒑鐠団€虫灀闁哄懐濞€楠炲﹤顭ㄩ崨顓熺€冲┑鈽嗗灥濡椼劍绔?
SD_Error CmdResp6Error(u8 cmd,u16*prca)
{
	SD_Error errorstatus=SD_OK;
	u32 status;
	u32 rspr1;
	u32 timeout=SDIO_CMD0TIMEOUT;
	while(timeout--)
	{
		status=SDIO->STA;
		if(status&((1<<0)|(1<<2)|(1<<6)))break;//CRC闂傚倸鍊烽悞锔锯偓绗涘洦鍋￠柕濞炬櫓閺?闂傚倷绀侀幉锛勭矙閹烘鍨傛繝闈涱儏缁狀噣鏌曢崼婵愭Ц濞磋偐濮烽埀顒€绠嶉崕閬嶅箠閹邦喒鍋撻悷閭︽█闁诡喗妞介獮鎺楀箣閻愬弶顏℃繝?闂佽姘﹂～澶愭偤閺囩姳鐒婃繛鍡樺灥閸ㄦ繈鏌ㄩ悢鍝勑㈢紓浣叉櫊閹綊宕崟顒佸創闂佺粯鎸搁崐鍧楀蓟濞戞ǚ鏀介柛鈩冾伔閵忋垻纾?CRC闂傚倷绀侀幖顐ょ矙閸曨厽宕叉繝闈涱儐閸嬫ɑ绻涢崱妯诲碍缂佺媴缍侀弻鐔兼焽閿曗偓婢ь喗銇?
	}
	if(timeout==0U)
	{
		SDIO_ClearFlag(SDIO_STATIC_FLAGS);
		return SD_CMD_RSP_TIMEOUT;
	}
	if(SDIO_GetFlagStatus(SDIO_FLAG_CTIMEOUT) != RESET)
	{
		SDIO_ClearFlag(SDIO_FLAG_CTIMEOUT);
		return SD_CMD_RSP_TIMEOUT;
	}
	if(SDIO_GetFlagStatus(SDIO_FLAG_CCRCFAIL) != RESET)
	{
		SDIO_ClearFlag(SDIO_FLAG_CCRCFAIL);
		return SD_CMD_CRC_FAIL;
	}
	if(SDIO->RESPCMD!=cmd)
	{
		return SD_ILLEGAL_CMD;
	}
	rspr1=SDIO->RESP1;
	SDIO_ClearFlag(SDIO_STATIC_FLAGS);
	*prca = (u16)(rspr1>>16);
	return errorstatus;
}

//SDIO濠电姷鏁搁崑鐘诲箵椤忓棗绶ら柦妯侯樈閻掍粙鏌ㄩ悢鍝勑㈤柡瀣╃窔閺岀喖骞戦幇闈涙缂備胶瀚忛崶銊у幐婵犮垼娉涢敃锔界閵忋倖鐓熸い顓熷笧缁♀偓闂佸搫鐬奸崰鎰八囬悧鍫熷劅闁炽儱鍟跨粻锝夋⒒娴ｈ姤銆冮柣鎺炵畵楠炴垿宕惰閸ゆ洘銇勯幒鎴濐仼閸ユ挳姊虹化鏇炲⒉妞ゃ劌绻戠€靛ジ骞樼紒妯锋嫽婵炶揪缍€婵倗娑甸崼鏇熺厱闁绘ê鍟挎慨宥団偓娈垮枛閹诧紕鎹㈠┑鍡╂僵妞ゆ帒鍋嗛崬鐢告⒒閸屾瑧顦﹂柣蹇旂箞閹兘寮埀顒勫箯閸涙潙绀堥柟缁樺笚椤?
//enx:0,闂傚倸鍊搁崐宄懊归崶褉鏋栭柡鍥ュ灩缁愭鏌熼悧鍫熺凡闁告垹濮撮埞鎴︽偐鐎圭姴顥濈紓浣哄閸ㄥ爼寮昏椤繈顢楅埀顒勫焵椤掍焦鍊愰柛鈹垮灱缁犳稑鈽夊▎灞惧闂佽崵濮垫禍浠嬪礉瀹€鍕嚑闁硅揪闄勯悡娑㈡倵閿濆簼鎲鹃柣鎾冲悑椤?1,濠电姷鏁搁崑鐘诲箵椤忓棗绶ら柦妯侯樈閻掍粙鏌ㄩ悢鍝勑㈤柡瀣╃窔閺岀喖骞戦幇闈涙濠碘槅鍋呴敃銏ゅ蓟閺囥垹閱囨繝闈涙祩濡偛顪?
//闂傚倸鍊搁崐宄懊归崶褉鏋栭柡鍥ュ灩缁愭鏌熼悧鍫熺凡闁告垹濮撮埞鎴︽偐鐎圭姴顥濈紓浣哄閸ㄥ爼寮婚敐澶婄闁挎繂鎲涢幘缁樼厸闁告侗鍠楅崐鎰版煛瀹€瀣瘈鐎规洘甯掕灒閻炴稈鈧厖澹曢梺鍝勭▉閸嬧偓闁稿鎸搁～婵嬵敆閸屾簽銊╂倵?闂傚倸鍊搁崐宄懊归崶褉鏋栭柡鍥ュ灩缁愭鏌熼悧鍫熺凡闁告垹濮撮埞鎴︽偐鐎圭姴顥濈紓浣哄閸ㄥ爼寮婚敐澶婄闁挎繂鎲涢幘缁樼厸闁告侗鍠楅崐鎰版煛瀹€瀣瘈鐎规洘甯掕灒閻炴稈鈧厖澹曢梺鍝勭▉閸嬧偓闁稿鎸搁～婵嬵敆閸屾簽銊╂⒑鐠団€虫灀闁哄懐濞€楠炲﹤顭ㄩ崨顓熺€冲┑鈽嗗灥濡椼劍绔?
SD_Error SDEnWideBus(u8 enx)
{
	SD_Error errorstatus = SD_OK;
 	u32 scr[2]={0,0};
	u8 arg=0X00;
	if(enx)arg=0X02;
	else arg=0X00;
 	if(SDIO->RESP1&SD_CARD_LOCKED)return SD_LOCK_UNLOCK_FAILED;//SD闂傚倸鍊搁崐宄懊归崶褉鏋栭柡鍥ュ灩缁愭鏌熼悧鍫熺凡闁告垹濮撮埞鎴︽偐鐎圭姴顥濈紓浣哄閸ㄥ爼寮婚敐澶婄闁挎繂鎲涢幘缁樼厸闁告侗鍠楅崐鎰版煛瀹€瀣瘈鐎规洘甯掕灒閻炴稈鈧厖澹曢梺鍝勭▉閸嬧偓闁稿鎸搁～婵嬵敆閸屾簽銊╂⒑閸濆嫯顫﹂柛鏃€鍨块獮鍐閵堝懎绐涙繝鐢靛Т鐎氼亞妲愰弴銏♀拻濞达絽鎽滅粔鐑樸亜閵夛附灏甸柣鎾存CKED闂傚倸鍊烽懗鍓佸垝椤栫偐鈧箓宕奸妷銉︽К闂佸搫绋侀崢濂告倿?	    
 	errorstatus=FindSCR(RCA,scr);						//闂傚倸鍊搁崐宄懊归崶褉鏋栭柡鍥ュ灩缁愭鏌熼崜褏甯涢柛瀣€归妵鍕箛閳轰讲鍋撻弴銏犲嚑闁割偅绻嶉悢鍡涙偣鏉炴媽顒熼柛搴＄箲閵囧嫯绠涢弴鍐┿偉R闂傚倸鍊搁崐宄懊归崶褉鏋栭柡鍥ュ灩缁愭鈧箍鍎遍ˇ浼村吹閹达箑绠规繛锝庡墮閻忣亞绱撳鍛枠闁哄矉缍侀獮鍥濞戞﹩娼绘俊鐐€曠换鎰版偉閻撳寒娼栭柧蹇氼潐瀹曞鏌曟繛鍨姕闁诲酣绠栧娲传閸曢潧鍓板銈庡幘閸忔﹢鎮伴璺ㄧ杸婵炴垶鐟ラ埀顒€顭烽弻銈夊箒閹烘垵濮曞┑鐐叉噷閸ㄨ棄顫忓ú顏勪紶闁告洦鍋€閸嬫捇宕奸弴鐐碉紮闂佸搫绋侀崑鈧柛瀣尭椤繈顢楅崒婧炪劑姊洪崫鍕潶闁告梹鍨块獮鍐閵堝懎绐涙繝鐢靛Т鐎氼亞妲愰弴銏♀拻?
 	if(errorstatus!=SD_OK)return errorstatus;
	if((scr[1]&SD_WIDE_BUS_SUPPORT)!=SD_ALLZERO)		//闂傚倸鍊峰ù鍥Υ閳ь剟鏌涚€ｎ偅灏伴柕鍥у瀵粙顢曢～顓熷媰闂備礁鎼幊蹇涘箖閸岀偛绠栭悹楦裤€€濡插牊绻涢崱妯曟垿鎮鹃崼鏇熺厽闊洦鎸剧粻浼存煙閾忣偓鑰块柣娑卞枦缁犳稑鈽夊▎蹇婂亾婵犳碍鐓犻柟顓熷笒閸旀粍绻涢崨顐㈢伈婵﹥妞藉畷顐﹀礋椤愮喎浜鹃柛顐ｆ礀绾惧綊鏌″搴′簮闁稿鎸搁～婵嬵敆閸屾簽銊╂⒑閸濆嫯顫﹂柛鏃€鍨块獮鍐閵堝懎绐涙繝鐢靛Т鐎氼亞妲愰弴銏♀拻?
	{
		  SDIO_CmdInitStructure.SDIO_Argument = (uint32_t) RCA << 16;//闂傚倸鍊搁崐宄懊归崶褉鏋栭柡鍥ュ灩缁愭鏌熼悧鍫熺凡闁告垹濮撮埞鎴︽偐鐎圭姴顥濈紓浣哄閸ㄥ爼寮婚敐澶婄闁挎繂鎲涢幘缁樼厸闁告侗鍠楅崐鎰版煛瀹€瀣瘈鐎规洘甯掕灒閻炴稈鈧厖澹曢梺鍝勭▉閸嬧偓闁稿鎸搁～婵囶潙閺嵮冨MD55+RCA,闂傚倸鍊搁崐宄懊归崶褉鏋栭柡鍥ュ灩缁愭鏌熼悧鍫熺凡闁告垹濮撮埞鎴︽偐鐎圭姴顥濈紓浣哄閸ㄥ爼寮婚敐澶婄闁挎繂鎲涢幘缁樼厸闁告侗鍠楅崐鎰版煛瀹€瀣瘈鐎规洘甯掕灒閻炴稈鈧厖澹曢梺鍝勭▉閸嬧偓闁稿鎸搁～婵嬪箛娴ｅ湱绉烽梻?
      SDIO_CmdInitStructure.SDIO_CmdIndex = SD_CMD_APP_CMD;
      SDIO_CmdInitStructure.SDIO_Response = SDIO_Response_Short;
      SDIO_CmdInitStructure.SDIO_Wait = SDIO_Wait_No;
      SDIO_CmdInitStructure.SDIO_CPSM = SDIO_CPSM_Enable;
      SDIO_SendCommand(&SDIO_CmdInitStructure);
		
	 	errorstatus=CmdResp1Error(SD_CMD_APP_CMD);
		
	 	if(errorstatus!=SD_OK)return errorstatus; 
		
		  SDIO_CmdInitStructure.SDIO_Argument = arg;//闂傚倸鍊搁崐宄懊归崶褉鏋栭柡鍥ュ灩缁愭鏌熼悧鍫熺凡闁告垹濮撮埞鎴︽偐鐎圭姴顥濈紓浣哄閸ㄥ爼寮婚敐澶婄闁挎繂鎲涢幘缁樼厸闁告侗鍠楅崐鎰版煛瀹€瀣瘈鐎规洘甯掕灒閻炴稈鈧厖澹曢梺鍝勭▉閸嬧偓闁稿鎸搁～婵囶潙閺嵮冨CMD6,闂傚倸鍊搁崐宄懊归崶褉鏋栭柡鍥ュ灩缁愭鏌熼悧鍫熺凡闁告垹濮撮埞鎴︽偐鐎圭姴顥濈紓浣哄閸ㄥ爼寮婚敐澶婄闁挎繂鎲涢幘缁樼厸闁告侗鍠楅崐鎰版煛瀹€瀣瘈鐎规洘甯掕灒閻炴稈鈧厖澹曢梺鍝勭▉閸嬧偓闁稿鎸搁～婵嬪箛娴ｅ湱绉烽梻?闂傚倸鍊搁崐宄懊归崶褉鏋栭柡鍥ュ灩缁愭鏌熼悧鍫熺凡闁告垹濮撮埞鎴︽偐鐎圭姴顥濈紓浣哄閸ㄥ爼寮婚敐澶婄闁挎繂鎲涢幘缁樼厸闁告侗鍠楅崐鎰版煛瀹€瀣瘈鐎规洘甯掕灒閻炴稈鈧厖澹曢梺鍝勭▉閸嬧偓闁?10,4濠?00,1濠?	
      SDIO_CmdInitStructure.SDIO_CmdIndex = SD_CMD_APP_SD_SET_BUSWIDTH;
      SDIO_CmdInitStructure.SDIO_Response = SDIO_Response_Short;
      SDIO_CmdInitStructure.SDIO_Wait = SDIO_Wait_No;
      SDIO_CmdInitStructure.SDIO_CPSM = SDIO_CPSM_Enable;
      SDIO_SendCommand(&SDIO_CmdInitStructure);
			
     errorstatus=CmdResp1Error(SD_CMD_APP_SD_SET_BUSWIDTH);
		
		return errorstatus;
	}else return SD_REQUEST_NOT_APPLICABLE;				//闂傚倸鍊搁崐宄懊归崶褉鏋栭柡鍥ュ灩缁愭鏌熼悧鍫熺凡闁告垹濮撮埞鎴︽偐鐎圭姴顥濈紓浣哄閸ㄨ泛顫忓ú顏勫瀭妞ゆ洖鎳庨崜閬嶆⒑閸濆嫭顥炵紒顔芥尭椤繘鎼圭憴鍕／闂侀潧顭堥崕鏌ユ倶閸℃娓婚柕鍫濆暙閻忣亞绱掗鑺ュ碍闁伙絿鍏橀幃鈺冩嫚閼碱剙濮堕梻浣告啞閸旓箓鎮￠崼鐔奉嚤闁瑰墽绮埛鎺懨归敐鍫澬撶痪顓炵埣閺屾盯鎮╅崘鎻掝潚閻庢鍠栭幉锛勬崲濠靛棭娼╂い鎺戝亞閸炵敻姊绘担铏瑰笡闁搞劌鍚嬮幈銊╁Χ婢跺﹦鏌ч梺褰掓？閻掞箓鎮″☉銏＄厱閻忕偘绠欓鍫濈劦妞ゆ帊鑳舵晶閬嶆煃瑜滈崜姘舵嚌閸撗呯濠电姴娲ら拑鐔兼煏婵炵偓娅嗛柛瀣閺屾稑鈽夊鍫濆婵炲鍘х€氭澘顫忔ウ瑁や汗闁圭儤绻冮ˉ鏍⒑缁嬭法绠查柨鏇樺灩椤曪綁顢曢敃鈧粻濠氭偣閸パ冪骇妞ゃ儲绻堝娲濞戞艾顣哄┑鈽嗗亝椤ㄥ﹪銆?	 
}												   
//闂傚倸鍊搁崐宄懊归崶褉鏋栭柡鍥ュ灩缁愭鏌熼悧鍫熺凡闁告垹濮撮埞鎴︽偐鐎圭姴顥濈紓浣哄閸ㄨ泛顫忓ú顏勫瀭妞ゆ梻鍋撻崳顔尖攽閻樼粯娑фい鎴濆€块崺鈧い鎺戯功閻ｅ灚顨ラ悙鏉戞诞妤犵偞锕㈤獮鍥ㄦ媴妞嬪骸顦╂繝鐢靛Х閺佹悂宕戝☉妯滄稑鈽夊▎鎴狀啎闂侀€炲苯澧撮柡灞稿墲閹峰懐鎲撮崟顐わ紦闁诲孩顔栭崳顕€宕滈悢闀愮箚闁割偅娲栭獮銏′繆閵堝拑姊楃紒鎲嬬畵濮婂宕掑▎鎰偘濠电偛顦板ú鐔风暦娴兼潙绠涢柡澶婄仢閸ゆ垶绻濋悽闈浶ｉ柤鐟板⒔缁顢涢悙瀵稿幗闂佺鎻徊鍊燁暱闂備礁鎼幊蹇涘箖閸岀偛绠栭悹楦裤€€濡插牊绻涢崱妯曟垿鎮炬禒瀣拺閻熸瑥瀚妵鐔访瑰搴濋偗闁绘侗鍠涚粻娑樷槈濞嗗繆鍋撴繝姘厾闁诡厽甯掗崝婊勭箾閸涱偄鐏叉慨濠冩そ瀹曘劍绻濋崟顒€娅ч梻浣侯焾椤戝懘藝閻㈠摜宓侀柟鐐た閺佸倿鏌涢锝囩畼妞ゆ柨妫濆铏圭磼濡櫣浼囨繝娈垮枔閸婃繂顕ｉ弻銉ョ濞达絽婀遍崢鎼佹⒑缁嬫寧婀伴柨姘舵煃瑜滈崜姘舵偋濠婂牆鐒垫い鎺嶆祰婢规绱撳鍜冭含鐎?
//pstatus:闂傚倸鍊搁崐宄懊归崶褉鏋栭柡鍥ュ灩缁愭鏌熼悧鍫熺凡闁告垹濮撮埞鎴︽偐鐎圭姴顥濈紓浣哄閸ㄦ娊鍩€椤掑倹鍤€閻庢凹鍘奸…鍨潨閳ь剝鐭鹃梺鍛婄☉閻°劑鎮￠悢闀愮箚妞ゆ牗姘ㄦ禒銏ゆ煟閹炬潙濮嶉柡?
//闂傚倸鍊搁崐宄懊归崶褉鏋栭柡鍥ュ灩缁愭鏌熼悧鍫熺凡闁告垹濮撮埞鎴︽偐鐎圭姴顥濈紓浣哄閸ㄥ爼寮婚敐澶婄闁挎繂鎲涢幘缁樼厸闁告侗鍠楅崐鎰版煛瀹€瀣瘈鐎规洘甯掕灒閻炴稈鈧厖澹曢梺鍝勭▉閸嬧偓闁稿鎸搁～婵嬵敆閸屾簽銊╂倵?闂傚倸鍊搁崐宄懊归崶褉鏋栭柡鍥ュ灩缁愭鏌熼悧鍫熺凡闁告垹濮撮埞鎴︽偐鐎圭姴顥濈紓浣哄閸ㄥ爼寮婚敐澶婄闁挎繂鎲涢幘缁樼厸闁告侗鍠楅崐鎰版煛瀹€瀣瘈鐎规洘甯掕灒閻炴稈鈧厖澹曢梺鍝勭▉閸嬧偓闁稿鎸搁～婵嬵敆閸屾簽銊╂⒑閸濆嫯顫﹂柛鏃€鍨块獮鍐閵堝懎绐涙繝鐢靛Т鐎氼亞妲愰弴銏♀拻濞达絽鎽滅粔鐑樸亜閵夛附宕岀€规洘顨呴～婊堝焵椤掆偓椤?
SD_Error IsCardProgramming(u8 *pstatus)
{
 	vu32 respR1 = 0, status = 0;  
  
  SDIO_CmdInitStructure.SDIO_Argument = (uint32_t) RCA << 16; //闂傚倸鍊搁崐宄懊归崶褉鏋栭柡鍥ュ灩缁愭鏌熼悧鍫熺凡闁告垹濮撮埞鎴︽偐鐎圭姴顥濈紓浣哄閸ㄥ爼寮婚敐澶婄闁挎繂鎲涢幘缁樼厸闁告侗鍠楅崐鎰版煛瀹€瀣瘈鐎规洘甯掕灒閻炴稈鈧厖澹曢梺鍝勭▉閸嬧偓闁稿鎸搁～婵嬵敆娴ｇ晫顢呯紓鍌欐祰妞存悂骞愰幖渚婄稏婵犲﹤鐗嗛悞鍨亜閹烘垵顏╅柡瀣╃窔閺岀喖骞戦幇顒傚帿闂佺顑嗚摫濞ｅ洤锕俊鍫曞磼濮橆偄顥氶梻鍌欑劍閹爼宕愰弽顓熷亱闁绘宕靛畵渚€鐓崶銊р姇闁稿﹤顭烽弻銈夊箒閹烘垵濮曞┑鐐叉噷閸ㄨ棄顫忓ú顏勪紶闁告洦鍋€閸嬫捇宕奸弴鐐碉紮闂佸搫绋侀崑鈧柛瀣尭椤繈顢楅崒婧炪劑姊?
  SDIO_CmdInitStructure.SDIO_CmdIndex = SD_CMD_SEND_STATUS;//闂傚倸鍊搁崐宄懊归崶褉鏋栭柡鍥ュ灩缁愭鏌熼悧鍫熺凡闁告垹濮撮埞鎴︽偐鐎圭姴顥濈紓浣哄閸ㄥ爼寮婚敐澶婄闁挎繂鎲涢幘缁樼厸闁告侗鍠楅崐鎰版煛瀹€瀣瘈鐎规洘甯掕灒閻炴稈鈧厖澹曢梺鍝勭▉閸嬧偓闁稿鎸搁～婵囶潙閺嵮冨MD13 	
  SDIO_CmdInitStructure.SDIO_Response = SDIO_Response_Short;
  SDIO_CmdInitStructure.SDIO_Wait = SDIO_Wait_No;
  SDIO_CmdInitStructure.SDIO_CPSM = SDIO_CPSM_Enable;
  SDIO_SendCommand(&SDIO_CmdInitStructure);	
 	
	status=SDIO->STA;
	
	while(!(status&((1<<0)|(1<<6)|(1<<2))))status=SDIO->STA;//闂傚倸鍊搁崐宄懊归崶褉鏋栭柡鍥ュ灩缁愭鏌″搴″箹閸ユ挳姊虹紒妯虹仸閽冭京绱撳鍛枠闁哄矉缍侀獮鍥濞戞﹩娼绘俊鐐€曠换鎰版偉閻撳寒娼栭柧蹇氼潐瀹曞鏌曟繛鍨姕闁诲酣绠栧娲传閸曢潧鍓板銈庡幘閸忔﹢鎮伴璺ㄧ杸婵炴垶鐟ラ埀顒€顭烽弻銈夊箒閹烘垵濮曞┑鐐叉噷閸ㄨ棄顫忓ú顏勪紶闁告洦鍋€閸嬫捇宕奸弴鐐碉紮闂佸搫绋侀崑鈧柛瀣尭椤繈顢楅崒婧炪劑姊洪崫鍕潶闁告梹鍨块獮鍐閵堝懎绐涙繝鐢靛Т鐎氼亞妲愰弴銏♀拻濞达絽鎽滅粔鐑樸亜閵夛附宕岀€规洘顨呴～婊堝焵椤掆偓椤?
   	if(SDIO_GetFlagStatus(SDIO_FLAG_CCRCFAIL) != RESET)			//CRC闂傚倸鍊搁崐宄懊归崶褉鏋栭柡鍥ュ灩缁愭鏌熼悧鍫熺凡闁告垹濮撮埞鎴︽偐鐎圭姴顥濈紓浣哄閸ㄥ爼寮婚敐澶婄闁挎繂鎲涢幘缁樼厸闁告侗鍘介幉鍝ョ磼鏉堛劍灏伴柟宄版嚇瀹曨偊宕熼妸銉ゅ濡炪倖鐗楅崙褰掑触鐎ｎ喗鐓曢柍鈺佸枤濞堛垹霉閸忓吋宕屾慨?
	{  
	  SDIO_ClearFlag(SDIO_FLAG_CCRCFAIL);	//闂傚倸鍊搁崐宄懊归崶褉鏋栭柡鍥ュ灩缁愭鏌熼悧鍫熺凡闁告垹濮撮埞鎴︽偐鐎圭姴顥濈紓浣哄閸ㄥ爼寮婚敐澶婄闁挎繂鎲涢幘缁樼厸闁告侗鍠楅崐鎰版煛瀹€瀣瘈鐎规洘甯掕灒閻炴稈鈧厖澹曢梺鍝勭▉閸嬧偓闁稿鎸搁～婵嬵敆閸屾簽銊╂⒑閸濆嫯顫﹂柛鏃€鍨块獮鍐閵堝懎绐涙繝鐢靛Т鐎氼亞妲愰弴銏♀拻濞达絽鎽滅粔鐑樸亜閵夛附宕岀€规洘顨呴～婊堝焵椤掆偓椤曪綁顢曢敃鈧粻濠氭偣閸パ冪骇妞ゃ儲绻堝娲濞戞艾顣哄┑鈽嗗亝椤ㄥ﹪銆侀弮鍫濋唶闁哄洨鍟块幏?
		return SD_CMD_CRC_FAIL;
	}
   	if(SDIO_GetFlagStatus(SDIO_FLAG_CTIMEOUT) != RESET)			//闂傚倸鍊搁崐宄懊归崶褉鏋栭柡鍥ュ灩缁愭鏌熼悧鍫熺凡闁告垹濮撮埞鎴︽偐鐎圭姴顥濈紓浣哄閸ㄥ爼寮婚敐澶婄闁挎繂鎲涢幘缁樼厸闁告侗鍘介幉鍝ョ磼鏉堛劌绗掗柍钘夘槸椤粓宕卞Δ鈧竟宥囩磽閸屾瑧顦︽い锔垮嵆楠炴劙宕樺顔兼?
	{
		SDIO_ClearFlag(SDIO_FLAG_CTIMEOUT);			//闂傚倸鍊搁崐宄懊归崶褉鏋栭柡鍥ュ灩缁愭鏌熼悧鍫熺凡闁告垹濮撮埞鎴︽偐鐎圭姴顥濈紓浣哄閸ㄥ爼寮婚敐澶婄闁挎繂鎲涢幘缁樼厸闁告侗鍠楅崐鎰版煛瀹€瀣瘈鐎规洘甯掕灒閻炴稈鈧厖澹曢梺鍝勭▉閸嬧偓闁稿鎸搁～婵嬵敆閸屾簽銊╂⒑閸濆嫯顫﹂柛鏃€鍨块獮鍐閵堝懎绐涙繝鐢靛Т鐎氼亞妲愰弴銏♀拻濞达絽鎽滅粔鐑樸亜閵夛附宕岀€规洘顨呴～婊堝焵椤掆偓椤曪綁顢曢敃鈧粻濠氭偣閸パ冪骇妞ゃ儲绻堝娲濞戞艾顣哄┑鈽嗗亝椤ㄥ﹪銆侀弮鍫濋唶闁哄洨鍟块幏?
		return SD_CMD_RSP_TIMEOUT;
	}
 	if(SDIO->RESPCMD!=SD_CMD_SEND_STATUS)return SD_ILLEGAL_CMD;
	SDIO_ClearFlag(SDIO_STATIC_FLAGS);//闂傚倸鍊搁崐宄懊归崶褉鏋栭柡鍥ュ灩缁愭鏌熼悧鍫熺凡闁告垹濮撮埞鎴︽偐鐎圭姴顥濈紓浣哄閸ㄥ爼寮婚敐澶婄闁挎繂鎲涢幘缁樼厸闁告侗鍠楅崐鎰版煛瀹€瀣瘈鐎规洘甯掕灒閻炴稈鈧厖澹曢梺鍝勭▉閸嬧偓闁稿鎸搁～婵嬵敆閸屾簽銊╂⒑閸濆嫯顫﹂柛鏃€鍨块獮鍐閵堝懎绐涙繝鐢靛Т鐎氼亞妲愰弴銏♀拻濞达絽鎲＄拹锟犳煕韫囨棑鑰跨€殿喓鍔戦弻鍡楊吋閸涱厼娈ら梻浣稿暱閹碱偊骞婅箛娑欏亗闁靛鏅滈悡鐔兼煛閸屾稑顕滈柛鐔哄仱閺岋綀绠涢敐鍛彎闂?
	respR1=SDIO->RESP1;
	*pstatus=(u8)((respR1>>9)&0x0000000F);
	return SD_OK;
}
//闂傚倸鍊搁崐宄懊归崶褉鏋栭柡鍥ュ灩缁愭鏌熼悧鍫熺凡闁告垹濮撮埞鎴︽偐鐎圭姴顥濈紓浣哄閸ㄦ娊鍩€椤掑倹鍤€閻庢凹鍘奸…鍨熼悡搴ｇ瓘闂佺鍕垫畷闁抽攱鍨块幃褰掑箒閹烘垵顬堥梺鍝勵儐閸ㄥ潡寮婚敍鍕ㄥ亾閿濆簼鎲鹃柣鎾冲悑椤ㄣ儵鎮欓懠顒傤唶闂佷紮缍囩换婵嗩嚕鐠鸿　鏋庨柣鎰靛墰閳ь剦鍋婂濠氬磼濞嗘劗銈板┑鐐差槹濞茬喎鐣锋导鏉戠疀闁哄鐏濋崵鎴炵節閻㈤潧校闁肩懓澧界划濠氼敍濮樺吋瀵岄柣搴秵娴滎亪顢撳Δ鍐當闁硅揪闄勯埛?
//pcardstatus:闂傚倸鍊搁崐宄懊归崶褉鏋栭柡鍥ュ灩缁愭鏌熼悧鍫熺凡闁告垹濮撮埞鎴︽偐鐎圭姴顥濈紓浣哄閸ㄤ即鈥旈崘顏佸亾閿濆簼閭い搴㈩殘缁參骞嬮敂瑙ｆ嫼?
//闂傚倸鍊搁崐宄懊归崶褉鏋栭柡鍥ュ灩缁愭鏌熼悧鍫熺凡闁告垹濮撮埞鎴︽偐鐎圭姴顥濈紓浣哄閸ㄥ爼寮婚敐澶婄闁挎繂鎲涢幘缁樼厸闁告侗鍠楅崐鎰版煛瀹€瀣瘈鐎规洘甯掕灒閻炴稈鈧厖澹曢梺鍝勭▉閸嬧偓闁稿鎸搁～婵嬵敆閸屾簽銊╂倵?闂傚倸鍊搁崐宄懊归崶褉鏋栭柡鍥ュ灩缁愭鏌熼悧鍫熺凡闁告垹濮撮埞鎴︽偐鐎圭姴顥濈紓浣哄閸ㄥ爼寮婚敐澶婄闁挎繂鎲涢幘缁樼厸闁告侗鍠楅崐鎰版煛瀹€瀣瘈鐎规洘甯掕灒閻炴稈鈧厖澹曢梺鍝勭▉閸嬧偓闁稿鎸搁～婵嬵敆閸屾簽銊╂⒑閸濆嫯顫﹂柛鏃€鍨块獮鍐閵堝懎绐涙繝鐢靛Т鐎氼亞妲愰弴銏♀拻濞达絽鎽滅粔鐑樸亜閵夛附宕岀€规洘顨呴～婊堝焵椤掆偓椤?
SD_Error SD_SendStatus(uint32_t *pcardstatus)
{
	SD_Error errorstatus = SD_OK;
	if(pcardstatus==NULL)
	{
		errorstatus=SD_INVALID_PARAMETER;
		return errorstatus;
	}
	
	SDIO_CmdInitStructure.SDIO_Argument = (uint32_t) RCA << 16;//闂傚倸鍊搁崐宄懊归崶褉鏋栭柡鍥ュ灩缁愭鏌熼悧鍫熺凡闁告垹濮撮埞鎴︽偐鐎圭姴顥濈紓浣哄閸ㄥ爼寮婚敐澶婄闁挎繂鎲涢幘缁樼厸闁告侗鍠楅崐鎰版煛瀹€瀣瘈鐎规洘甯掕灒閻炴稈鈧厖澹曢梺鍝勭▉閸嬧偓闁稿鎸搁～婵囶潙閺嵮冨MD13,闂傚倸鍊搁崐宄懊归崶褉鏋栭柡鍥ュ灩缁愭鏌熼悧鍫熺凡闁告垹濮撮埞鎴︽偐鐎圭姴顥濈紓浣哄閸ㄥ爼寮婚敐澶婄闁挎繂鎲涢幘缁樼厸闁告侗鍠楅崐鎰版煛瀹€瀣瘈鐎规洘甯掕灒閻炴稈鈧厖澹曢梺鍝勭▉閸嬧偓闁稿鎸搁～婵嬪箛娴ｅ湱绉烽梻?	 
  SDIO_CmdInitStructure.SDIO_CmdIndex = SD_CMD_SEND_STATUS;
  SDIO_CmdInitStructure.SDIO_Response = SDIO_Response_Short;
  SDIO_CmdInitStructure.SDIO_Wait = SDIO_Wait_No;
  SDIO_CmdInitStructure.SDIO_CPSM = SDIO_CPSM_Enable;
  SDIO_SendCommand(&SDIO_CmdInitStructure);	
	
	errorstatus=CmdResp1Error(SD_CMD_SEND_STATUS);	//闂傚倸鍊搁崐宄懊归崶褉鏋栭柡鍥ュ灩缁愭鏌熼悧鍫熺凡闁告垹濮撮埞鎴︽偐鐎圭姴顥濈紓浣哄閸ㄥ爼寮婚敐澶娢ч幖杈剧磿娴煎洭姊洪幖鐐测偓鏇犫偓姘緲椤繘鎼圭憴鍕／闂侀潧顭堥崕鏌ユ倵妤ｅ啯鈷戦柛婵嗗閸庡繑銇勯鐘插幋闁绘侗鍠涚粻娑㈠箻閼稿灚鐤傞梻浣筋潐椤旀牠宕伴弽顓熷仼闁靛ň鏅滈埛鎴犵磽娴ｇ櫢渚涢柣鎺楃畺閺屾盯鍩￠崒婊冣拰闂佺硶鏂侀崑?
	if(errorstatus!=SD_OK)return errorstatus;
	*pcardstatus=SDIO->RESP1;//闂傚倸鍊搁崐宄懊归崶褉鏋栭柡鍥ュ灩缁愭鏌熼悧鍫熺凡闁告垹濮撮埞鎴︽偐鐎圭姴顥濈紓浣哄閸ㄦ娊鍩€椤掑倹鍤€閻庢凹鍘奸…鍨熼悡搴ｇ瓘闂佺鍕垫畷闁抽攱鍨块幃褰掑箒閹烘垵顬堥梺鍝勵儐閸ㄥ潡寮婚敍鍕ㄥ亾閿濆簼鎲鹃柣鎾冲悑椤ㄣ儵鎮欓懠顒傤唶闂佷紮缍囩换婵嬬嵁瀹ュ鏁婇柤娴嬫櫆濞堁囨⒒?
	return errorstatus;
} 
//闂傚倸鍊搁崐宄懊归崶褉鏋栭柡鍥ュ灩缁愭鏌熼悧鍫熺凡闁告垹濮撮埞鎴︽偐鐎圭姴顥濈紓浣哄閸ㄥ爼寮婚敐澶婄闁挎繂鎲涢幘缁樼厸闁告侗鍠楅崐鎰版煛瀹€瀣瘈鐎规洘甯掕灒閻炴稈鈧厖澹曢梺鍝勭▉閸嬧偓闁稿鎸搁～婵囨綇閳哄倹鍟滵闂傚倸鍊搁崐宄懊归崶褉鏋栭柡鍥ュ灩缁愭鏌熼悧鍫熺凡闁告垹濮撮埞鎴︽偐鐎圭姴顥濈紓浣哄閸ㄥ爼寮婚敐澶婄闁挎繂鎲涢幘缁樼厸闁告侗鍠楅崐鎰版煛瀹€瀣瘈鐎规洘甯掕灒閻炴稈鈧厖澹曢梺鍝勭▉閸嬧偓闁稿鎸搁～婵嬵敆閸屾簽銊╂⒑鐠団€虫灀闁哄懐濞€楠炲﹤顭ㄩ崨顓熺€冲┑鈽嗗灥濡椼劍绔?
//闂傚倸鍊搁崐宄懊归崶褉鏋栭柡鍥ュ灩缁愭鏌熼悧鍫熺凡闁告垹濮撮埞鎴︽偐鐎圭姴顥濈紓浣哄閸ㄥ爼寮婚敐澶婄闁挎繂鎲涢幘缁樼厸闁告侗鍠楅崐鎰版煛瀹€瀣瘈鐎规洘甯掕灒閻炴稈鈧厖澹曢梺鍝勭▉閸嬧偓闁稿鎸搁～婵嬵敆閸屾簽銊╂倵?SD闂傚倸鍊搁崐宄懊归崶褉鏋栭柡鍥ュ灩缁愭鏌熼悧鍫熺凡闁告垹濮撮埞鎴︽偐鐎圭姴顥濈紓浣哄閸ㄤ即鈥旈崘顏佸亾閿濆簼閭い搴㈩殘缁參骞嬮敂瑙ｆ嫼?
SDCardState SD_GetState(void)
{
	u32 resp1=0;
	if(SD_SendStatus(&resp1)!=SD_OK)return SD_CARD_ERROR;
	else return (SDCardState)((resp1>>9) & 0x0F);
}
//闂傚倸鍊搁崐宄懊归崶褉鏋栭柡鍥ュ灩缁愭鏌熼悧鍫熺凡闁告垹濮撮埞鎴︽偐鐎圭姴顥濈紓浣哄閸ㄥ爼寮婚敐澶婄闁挎繂鎲涢幘缁樼厸闁告侗鍠楅崐鎰版煛瀹€瀣瘈鐎规洘甯掕灒閻炴稈鈧厖澹曢梺鍝勭▉閸嬧偓闁稿鎸搁～婵囨綇閳哄倹鍟滵闂傚倸鍊搁崐宄懊归崶褉鏋栭柡鍥ュ灩缁愭鏌熼悧鍫熺凡闁告垹濮撮埞鎴︽偐鐎圭姴顥濈紓浣哄閸ㄥ爼寮婚敐澶婄闁挎繂鎲涢幘缁樼厸闁告侗鍠楅崐鎰版煛瀹€瀣瘈鐎规洘甯掕灒閻炴稈鈧厖澹曢梺鍝勭▉閸嬧偓闁稿鎸搁～婵囨綇閳哄倹鍟滳R闂傚倸鍊搁崐宄懊归崶褉鏋栭柡鍥ュ灩缁愭鈧箍鍎遍ˇ浼村吹閹达箑绠规繛锝庡墮閻忣亞绱撳鍛枠闁哄矉缍侀獮鍥濞戞﹩娼绘俊鐐€曠换鎰版偉閻撳寒娼栭柧蹇氼潐瀹曞鏌曟繛鍨姕闁诲酣绠栧娲传閸曢潧鍓板銈庡幘閸忔﹢鎮伴璺ㄧ杸闁规崘鍩栧▓婵嬫⒑瑜版帗娑ч柛鐔稿缁?
//rca:闂傚倸鍊搁崐宄懊归崶褉鏋栭柡鍥ュ灩缁愭鏌熼悧鍫熺凡闁告垹濮撮埞鎴︽偐鐎圭姴顥濈紓浣哄閸ㄥ爼寮婚敐澶婄闁挎繂鎲涢幘缁樼厸闁告侗鍠楅崐鎰版煛瀹€瀣瘈鐎规洘甯掕灒閻炴稈鈧厖澹曢梺鍝勭▉閸嬧偓闁稿鎸搁～婵嬵敆娴ｇ晫顢呯紓鍌欐祰妞存悂骞愰幖渚婄稏婵犲﹤鐗嗛悞鍨亜閹烘垵顏╅柡瀣╃窔閺岀喖骞戦幇顒傚帿闂?
//pscr:闂傚倸鍊搁崐宄懊归崶褉鏋栭柡鍥ュ灩缁愭鏌熼悧鍫熺凡闁告垹濮撮埞鎴︽偐鐎圭姴顥濈紓浣哄閸ㄥ爼寮婚敐澶婄闁挎繂鎲涢幘缁樼厸闁告侗鍠楅崐鎰版煛瀹€鈧崰鎾斥槈閻㈢宸濇い鏂跨仢閹懐绱撻崒娆戠獢缁绢厽鎮傚畷鎶芥晲婢跺苯绁﹂棅顐㈡处缁嬫帡宕愭繝姘厾闁诡厽甯掗崝婊勭箾閸涱偄鐏叉慨濠冩そ瀹曨偊宕熼鐔蜂壕闁割偅娲栫壕褰掓煛瀹ュ骸浜愰柛瀣尭椤繈顢楅崒婧炪劑姊洪崫鍕潶闁告梹鍨块獮鍐閵堝懎绐涙繝鐢靛Т鐎氼亞妲愰弴銏♀拻?闂傚倸鍊搁崐宄懊归崶褉鏋栭柡鍥ュ灩缁愭鏌￠崶鈺佹瀾闁告瑥绻橀弻鏇㈠醇濠垫劖笑缂佺偓鍎抽妶鎼佸蓟瀹ュ鏁嶆繝濠傛娴滅碀闂傚倸鍊搁崐宄懊归崶褉鏋栭柡鍥ュ灩缁愭鏌熼悧鍫熺凡闁告垹濮撮埞鎴︽偐鐎圭姴顥濈紓浣哄閸ㄥ爼寮婚敐澶婄闁挎繂鎲涢幘缁樼厸闁告侗鍠楅崐鎰版煛瀹€瀣瘈鐎规洘甯掕灒閻炴稈鈧厖澹曢梺鍝勭▉閸嬧偓闁?
//闂傚倸鍊搁崐宄懊归崶褉鏋栭柡鍥ュ灩缁愭鏌熼悧鍫熺凡闁告垹濮撮埞鎴︽偐鐎圭姴顥濈紓浣哄閸ㄥ爼寮婚敐澶婄闁挎繂鎲涢幘缁樼厸闁告侗鍠楅崐鎰版煛瀹€瀣瘈鐎规洘甯掕灒閻炴稈鈧厖澹曢梺鍝勭▉閸嬧偓闁稿鎸搁～婵嬵敆閸屾簽銊╂倵?闂傚倸鍊搁崐宄懊归崶褉鏋栭柡鍥ュ灩缁愭鏌熼悧鍫熺凡闁告垹濮撮埞鎴︽偐鐎圭姴顥濈紓浣哄閸ㄥ爼寮婚敐澶婄闁挎繂鎲涢幘缁樼厸闁告侗鍠楅崐鎰版煛瀹€瀣瘈鐎规洘甯掕灒閻炴稈鈧厖澹曢梺鍝勭▉閸嬧偓闁稿鎸搁～婵嬵敆閸屾簽銊╂⒑鐠団€虫灀闁哄懐濞€楠炲﹤顭ㄩ崨顓熺€冲┑鈽嗗灥濡椼劍绔?	   
SD_Error FindSCR(u16 rca,u32 *pscr)
{ 
	u32 index = 0; 
	SD_Error errorstatus = SD_OK;
	u32 tempscr[2]={0,0};  
	
	SDIO_CmdInitStructure.SDIO_Argument = (uint32_t)8;	 //闂傚倸鍊搁崐宄懊归崶褉鏋栭柡鍥ュ灩缁愭鏌熼悧鍫熺凡闁告垹濮撮埞鎴︽偐鐎圭姴顥濈紓浣哄閸ㄥ爼寮婚敐澶婄闁挎繂鎲涢幘缁樼厸闁告侗鍠楅崐鎰版煛瀹€瀣瘈鐎规洘甯掕灒閻炴稈鈧厖澹曢梺鍝勭▉閸嬧偓闁稿鎸搁～婵囶潙閺嵮冨MD16,闂傚倸鍊搁崐宄懊归崶褉鏋栭柡鍥ュ灩缁愭鏌熼悧鍫熺凡闁告垹濮撮埞鎴︽偐鐎圭姴顥濈紓浣哄閸ㄥ爼寮婚敐澶婄闁挎繂鎲涢幘缁樼厸闁告侗鍠楅崐鎰版煛瀹€瀣瘈鐎规洘甯掕灒閻炴稈鈧厖澹曢梺鍝勭▉閸嬧偓闁稿鎸搁～婵嬪箛娴ｅ湱绉烽梻?闂傚倸鍊搁崐宄懊归崶褉鏋栭柡鍥ュ灩缁愭鏌熼悧鍫熺凡闁告垹濮撮埞鎴︽偐鐎圭姴顥濈紓浣哄閸ㄥ爼寮婚敐澶婄闁挎繂鎲涢幘缁樼厸闁告侗鍠楅崐鎰版煛瀹€瀣瘈鐎规洘甯掕灒閻炴稈鈧厖澹曢梺鍝勭▉閸嬧偓闁稿鎸搁～婵囶潙閺嵮冨lock Size濠?闂傚倸鍊搁崐宄懊归崶褉鏋栭柡鍥ュ灩缁愭鏌￠崶鑸靛▏闁逞屽厸缁€渚€鈥﹂妸鈺侀唶婵犻潧娴傚Λ鐔兼⒒娓氣偓濞佳囨偋閸℃あ娑樜旈崪浣规櫆?
  SDIO_CmdInitStructure.SDIO_CmdIndex = SD_CMD_SET_BLOCKLEN; //	 cmd16
  SDIO_CmdInitStructure.SDIO_Response = SDIO_Response_Short;  //r1
  SDIO_CmdInitStructure.SDIO_Wait = SDIO_Wait_No;
  SDIO_CmdInitStructure.SDIO_CPSM = SDIO_CPSM_Enable;
  SDIO_SendCommand(&SDIO_CmdInitStructure);
	
 	errorstatus=CmdResp1Error(SD_CMD_SET_BLOCKLEN);
	
 	if(errorstatus!=SD_OK)return errorstatus;	 
	
  SDIO_CmdInitStructure.SDIO_Argument = (uint32_t) RCA << 16; 
  SDIO_CmdInitStructure.SDIO_CmdIndex = SD_CMD_APP_CMD;//闂傚倸鍊搁崐宄懊归崶褉鏋栭柡鍥ュ灩缁愭鏌熼悧鍫熺凡闁告垹濮撮埞鎴︽偐鐎圭姴顥濈紓浣哄閸ㄥ爼寮婚敐澶婄闁挎繂鎲涢幘缁樼厸闁告侗鍠楅崐鎰版煛瀹€瀣瘈鐎规洘甯掕灒閻炴稈鈧厖澹曢梺鍝勭▉閸嬧偓闁稿鎸搁～婵囶潙閺嵮冨MD55,闂傚倸鍊搁崐宄懊归崶褉鏋栭柡鍥ュ灩缁愭鏌熼悧鍫熺凡闁告垹濮撮埞鎴︽偐鐎圭姴顥濈紓浣哄閸ㄥ爼寮婚敐澶婄闁挎繂鎲涢幘缁樼厸闁告侗鍠楅崐鎰版煛瀹€瀣瘈鐎规洘甯掕灒閻炴稈鈧厖澹曢梺鍝勭▉閸嬧偓闁稿鎸搁～婵嬪箛娴ｅ湱绉烽梻?	
  SDIO_CmdInitStructure.SDIO_Response = SDIO_Response_Short;
  SDIO_CmdInitStructure.SDIO_Wait = SDIO_Wait_No;
  SDIO_CmdInitStructure.SDIO_CPSM = SDIO_CPSM_Enable;
  SDIO_SendCommand(&SDIO_CmdInitStructure);
	
 	errorstatus=CmdResp1Error(SD_CMD_APP_CMD);
 	if(errorstatus!=SD_OK)return errorstatus;
	
  SDIO_DataInitStructure.SDIO_DataTimeOut = SD_DATATIMEOUT;
  SDIO_DataInitStructure.SDIO_DataLength = 8;  //8闂傚倸鍊搁崐宄懊归崶褉鏋栭柡鍥ュ灩缁愭鏌熼悧鍫熺凡闁告垹濮撮埞鎴︽偐鐎圭姴顥濈紓浣哄閸ㄥ爼寮婚敐澶婄闁挎繂鎲涢幘缁樼厸闁告侗鍠楅崐鎰版煙椤旀寧纭鹃柍钘夘槸閳诲骸螣閼姐倖姣屾繝鐢靛Х椤ｈ棄危閸涙潙鍌ㄩ柛鎾楀啫鐏婇梺姹囧灩閻忔岸宕伴崱娑欑厱闁哄洢鍔屾禍钘壝归崗鍏煎磳婵﹦绮幏鍛存嚍閵壯佲偓濠囨⒑閸濄儱校闁告梹鐟ラ锝夊川婵犲嫮鐦堝┑顔斤供閸撴盯顢?block濠?闂傚倸鍊搁崐宄懊归崶褉鏋栭柡鍥ュ灩缁愭鏌￠崶鑸靛▏闁逞屽厸缁€渚€鈥﹂妸鈺侀唶婵犻潧娴傚Λ鐔兼⒒娓氣偓濞佳囨偋閸℃あ娑樜旈崪浣规櫆?SD闂傚倸鍊搁崐宄懊归崶褉鏋栭柡鍥ュ灩缁愭鏌熼悧鍫熺凡闁告垹濮撮埞鎴︽偐鐎圭姴顥濈紓浣哄閸ㄥ爼寮婚敐澶婄闁挎繂鎲涢幘缁樼厸闁告侗鍠楅崐鎰版煛瀹€瀣瘈鐎规洘甯掕灒閻炴稈鈧厖澹曢梺鍝勭▉閸嬧偓闁稿鎸搁～婵囨綇閳哄倹鍟滵IO.
  SDIO_DataInitStructure.SDIO_DataBlockSize = SDIO_DataBlockSize_8b  ;  //闂傚倸鍊搁崐宄懊归崶褉鏋栭柡鍥ュ灩缁愭鏌熼悧鍫熺凡闁告垹濮撮埞鎴︽偐鐎圭姴顥濈紓浣哄閸ㄥ爼寮婚敐澶婄闁挎繂鎲涢幘缁樼厸闁告侗鍠楅崐鎰版煛?byte 
  SDIO_DataInitStructure.SDIO_TransferDir = SDIO_TransferDir_ToSDIO;
  SDIO_DataInitStructure.SDIO_TransferMode = SDIO_TransferMode_Block;
  SDIO_DataInitStructure.SDIO_DPSM = SDIO_DPSM_Enable;
  SDIO_DataConfig(&SDIO_DataInitStructure);		

  SDIO_CmdInitStructure.SDIO_Argument = 0x0;
  SDIO_CmdInitStructure.SDIO_CmdIndex = SD_CMD_SD_APP_SEND_SCR;	//闂傚倸鍊搁崐宄懊归崶褉鏋栭柡鍥ュ灩缁愭鏌熼悧鍫熺凡闁告垹濮撮埞鎴︽偐鐎圭姴顥濈紓浣哄閸ㄥ爼寮婚敐澶婄闁挎繂鎲涢幘缁樼厸闁告侗鍠楅崐鎰版煛瀹€瀣瘈鐎规洘甯掕灒閻炴稈鈧厖澹曢梺鍝勭▉閸嬧偓闁稿鎸搁～婵囶潙閺嵮冨CMD51,闂傚倸鍊搁崐宄懊归崶褉鏋栭柡鍥ュ灩缁愭鏌熼悧鍫熺凡闁告垹濮撮埞鎴︽偐鐎圭姴顥濈紓浣哄閸ㄥ爼寮婚敐澶婄闁挎繂鎲涢幘缁樼厸闁告侗鍠楅崐鎰版煛瀹€瀣瘈鐎规洘甯掕灒閻炴稈鈧厖澹曢梺鍝勭▉閸嬧偓闁稿鎸搁～婵嬪箛娴ｅ湱绉烽梻?闂傚倸鍊搁崐宄懊归崶褉鏋栭柡鍥ュ灩缁愭鏌熼悧鍫熺凡闁告垹濮撮埞鎴︽偐鐎圭姴顥濈紓浣哄閸ㄥ爼寮婚敐澶婄闁挎繂鎲涢幘缁樼厸闁告侗鍠楅崐鎰版煛瀹€瀣瘈鐎规洘甯掕灒閻炴稈鈧厖澹曢梺鍝勭▉閸嬧偓闁稿鎸搁～婵嬪箛娴ｅ湱绉风紓?	
  SDIO_CmdInitStructure.SDIO_Response = SDIO_Response_Short;  //r1
  SDIO_CmdInitStructure.SDIO_Wait = SDIO_Wait_No;
  SDIO_CmdInitStructure.SDIO_CPSM = SDIO_CPSM_Enable;
  SDIO_SendCommand(&SDIO_CmdInitStructure);
	
 	errorstatus=CmdResp1Error(SD_CMD_SD_APP_SEND_SCR);
 	if(errorstatus!=SD_OK)return errorstatus;							   
 	while(!(SDIO->STA&(SDIO_FLAG_RXOVERR|SDIO_FLAG_DCRCFAIL|SDIO_FLAG_DTIMEOUT|SDIO_FLAG_DBCKEND|SDIO_FLAG_STBITERR)))
	{ 
		if(SDIO_GetFlagStatus(SDIO_FLAG_RXDAVL) != RESET)//闂傚倸鍊搁崐宄懊归崶褉鏋栭柡鍥ュ灩缁愭鏌熼悧鍫熺凡闁告垹濮撮埞鎴︽偐鐎圭姴顥濈紓浣哄閸ㄥ爼寮婚敐澶婄闁挎繂鎲涢幘缁樼厸闁告侗鍠楅崐鎰版煛瀹€瀣瘈鐎规洘甯掕灒閻炴稈鈧厖澹曢梺鍝勭▉閸嬧偓闁稿鎸搁～婵囶潙閺嵮冨ΠIFO闂傚倸鍊搁崐宄懊归崶褉鏋栭柡鍥ュ灩缁愭鏌熼悧鍫熺凡闁告垹濮撮埞鎴︽偐鐎圭姴顥濈紓浣哄閸ㄥ爼寮婚敐澶婄闁挎繂鎲涢幘缁樼厸闁告侗鍠楅崐鎰版煛瀹€鈧崰鏍箖閻戣棄绾ч柟绋垮珐閳哄懏鐓熼煫鍥ㄦ尵缁犱即鏌熼搹顐€块柣娑卞枦缁犳稑鈽夊▎蹇婂亾婵犳碍鐓犻柟顓熷笒閸旀粍绻涢崨顐㈢伈婵﹥妞藉畷顐﹀礋椤愮喎浜鹃柛顐ｆ礀绾惧綊鏌″搴′簮闁?
		{
			*(tempscr+index)=SDIO->FIFO;	//闂傚倸鍊搁崐宄懊归崶褉鏋栭柡鍥ュ灩缁愭鏌熼悧鍫熺凡闁告垹濮撮埞鎴︽偐鐎圭姴顥濈紓浣哄閸ㄦ娊鍩€椤掑倹鍤€閻庢凹鍘奸…鍨熼悡搴ｇ瓘缂備浇妗ㄥù鐡糘闂傚倸鍊搁崐宄懊归崶褉鏋栭柡鍥ュ灩缁愭鏌熼悧鍫熺凡闁告垹濮撮埞鎴︽偐鐎圭姴顥濈紓浣哄閸ㄥ爼寮婚敐澶婄闁挎繂鎲涢幘缁樼厸闁告侗鍠楅崐鎰版煛瀹€瀣瘈鐎规洘甯掕灒閻炴稈鈧厖澹曢梺鍝勭▉閸嬧偓闁?
			index++;
			if(index>=2)break;
		}
	}
		if(SDIO_GetFlagStatus(SDIO_FLAG_DTIMEOUT) != RESET)		//闂傚倸鍊搁崐宄懊归崶褉鏋栭柡鍥ュ灩缁愭鏌熼悧鍫熺凡闁告垹濮撮埞鎴︽偐鐎圭姴顥濈紓浣哄閸ㄥ爼寮婚敐澶婄闁挎繂鎲涢幘缁樼厸闁告侗鍠楅崐鎰版煛瀹€鈧崰鏇㈠Φ閹版澘绠虫繝闈涙祩濡牗淇婇悙顏勨偓鏍暜濡ゅ懏鍋傞柨鐔哄Х瀹撲線鐓崶銊р姇闁绘挶鍎甸幃妤呮晲鎼粹€茶埅濠碘€虫▕閸ㄨ泛顫忕紒妯诲闁兼亽鍎抽妴濠囨⒑閸濄儱校闁告梹鐟ラ锝夊川婵犲嫮鐦堝┑顔斤供閸撴盯顢欓崱娑欌拺缂備焦锚閻忓崬鈹戦鍝勨偓婵嗩嚕閺屻儱绠瑰ù锝呮贡閸樻悂姊虹粙鎸庢拱闁挎岸鏌嶈閸撴岸鎮у鍫濈劦?
		{										   
	 		SDIO_ClearFlag(SDIO_FLAG_DTIMEOUT); 	//闂傚倸鍊搁崐宄懊归崶褉鏋栭柡鍥ュ灩缁愭鏌熼悧鍫熺凡闁告垹濮撮埞鎴︽偐鐎圭姴顥濈紓浣哄閸ㄥ爼寮婚敐澶婄闁挎繂鎲涢幘缁樼厸闁告侗鍠楅崐鎰版煛瀹€瀣瘈鐎规洘甯掕灒閻炴稈鈧厖澹曢梺鍝勭▉閸嬧偓闁稿鎸搁～婵嬵敆閸屾簽銊╂⒑閸濆嫯顫﹂柛鏃€鍨块獮鍐閵堝懎绐涙繝鐢靛Т鐎氼亞妲愰弴銏♀拻濞达絿鍎ら崵鈧梺鎼炲灪閻撯€崇暦閺屻儲鍤戞い鎺嶇鎼?
			return SD_DATA_TIMEOUT;
	 	}else if(SDIO_GetFlagStatus(SDIO_FLAG_DCRCFAIL) != RESET)	//闂傚倸鍊搁崐宄懊归崶褉鏋栭柡鍥ュ灩缁愭鏌熼悧鍫熺凡闁告垹濮撮埞鎴︽偐鐎圭姴顥濈紓浣哄閸ㄥ爼寮婚敐澶婄闁挎繂鎲涢幘缁樼厸闁告侗鍠楅崐鎰版煛瀹€鈧崰鏍箖閻戣棄绾ч柟绋垮珐閳哄懏鐓熼煫鍥ㄦ尵缁犱即鏌熼搹顐€块柣娑卞枦缁犳盯寮撮悩鐢靛幆婵＄偑鍊戦崹濠氼敁閸儲鈷掗柛灞剧懄缁佺増绻涙径瀣鐎规洑鍗抽獮鍥级閸喖娈ゅ┑鐘垫暩婵敻鎳濋崜褏涓嶆い鏍仦閻撶喖鏌熸潏鍓у埌鐞氭岸姊洪崫鍕櫤闁诡喖鍊垮濠氭晸閻樿尙锛滃┑鈽嗗灥閵嗏偓闁稿鎹囧浠嬵敃閻旇渹澹?
		{
	 		SDIO_ClearFlag(SDIO_FLAG_DCRCFAIL);  		//闂傚倸鍊搁崐宄懊归崶褉鏋栭柡鍥ュ灩缁愭鏌熼悧鍫熺凡闁告垹濮撮埞鎴︽偐鐎圭姴顥濈紓浣哄閸ㄥ爼寮婚敐澶婄闁挎繂鎲涢幘缁樼厸闁告侗鍠楅崐鎰版煛瀹€瀣瘈鐎规洘甯掕灒閻炴稈鈧厖澹曢梺鍝勭▉閸嬧偓闁稿鎸搁～婵嬵敆閸屾簽銊╂⒑閸濆嫯顫﹂柛鏃€鍨块獮鍐閵堝懎绐涙繝鐢靛Т鐎氼亞妲愰弴銏♀拻濞达絿鍎ら崵鈧梺鎼炲灪閻撯€崇暦閺屻儲鍤戞い鎺嶇鎼?
			return SD_DATA_CRC_FAIL;		   
		}else if(SDIO_GetFlagStatus(SDIO_FLAG_RXOVERR) != RESET) 	//闂傚倸鍊搁崐宄懊归崶褉鏋栭柡鍥ュ灩缁愭鏌熼悧鍫熺凡闁告垹濮撮埞鎴︽偐鐎圭姴顥濈紓浣哄閸ㄥ爼寮婚敐澶婄闁挎繂鎲涢幘缁樼厸闁告侗鍠楅崐鎰版煛瀹€瀣瘈鐎规洘甯掕灒閻炴稈鈧厖澹曢梺鍝勭▉閸嬧偓闁稿鎸搁～婵囶潙閺嵮冾瀳ifo闂傚倸鍊搁崐宄懊归崶褉鏋栭柡鍥ュ灩缁愭鏌熼悧鍫熺凡闁告垹濮撮埞鎴︽偐鐎圭姴顥濈紓浣哄閸ㄥ爼寮婚敐澶婄闁挎繂鎲涢幘缁樼厸闁告侗鍠楅崐鎰版煛瀹€瀣瘈鐎规洘甯掕灒閻炴稈鈧厖澹曢梺鍝勭▉閸嬧偓闁稿鎸搁～婵嬵敆閸屾簽銊╂⒑閸濆嫯顫﹂柛鏃€鍨块獮鍐閵堝懎绐涙繝鐢靛Т鐎氼亞妲愰弴銏♀拻濞达絽鎽滅粔鐑樸亜閵夛附宕岀€规洘顨呴～婊堝焵椤掆偓椤?
		{
	 		SDIO_ClearFlag(SDIO_FLAG_RXOVERR);		//闂傚倸鍊搁崐宄懊归崶褉鏋栭柡鍥ュ灩缁愭鏌熼悧鍫熺凡闁告垹濮撮埞鎴︽偐鐎圭姴顥濈紓浣哄閸ㄥ爼寮婚敐澶婄闁挎繂鎲涢幘缁樼厸闁告侗鍠楅崐鎰版煛瀹€瀣瘈鐎规洘甯掕灒閻炴稈鈧厖澹曢梺鍝勭▉閸嬧偓闁稿鎸搁～婵嬵敆閸屾簽銊╂⒑閸濆嫯顫﹂柛鏃€鍨块獮鍐閵堝懎绐涙繝鐢靛Т鐎氼亞妲愰弴銏♀拻濞达絿鍎ら崵鈧梺鎼炲灪閻撯€崇暦閺屻儲鍤戞い鎺嶇鎼?
			return SD_RX_OVERRUN;		 
		}else if(SDIO_GetFlagStatus(SDIO_FLAG_STBITERR) != RESET) 	//闂傚倸鍊搁崐宄懊归崶褉鏋栭柡鍥ュ灩缁愭鏌熼悧鍫熺凡闁告垹濮撮埞鎴︽偐鐎圭姴顥濈紓浣哄閸ㄥ爼寮婚敐澶婄闁挎繂鎲涢幘缁樼厸闁告侗鍠楅崐鎰版煛瀹€瀣瘈鐎规洘甯掕灒閻炴稈鈧厖澹曢梺鍝勭▉閸嬧偓闁稿鎸搁～婵嬵敆閸屾簽銊╂⒑閸濆嫯顫﹂柛鏃€鍨块獮鍐閵堝懎绐涙繝鐢靛Т鐎氼亞妲愰弴銏♀拻濞达絿鍎ら崵鈧梺鎼炲灪閻撯€崇暦閺屻儱钃熼柕澶樺灣缁嬪繘姊鸿ぐ鎺戜喊闁告濮ら崚濠勨偓鐢电《閸嬫捇鐛崹顔煎濡炪倧缂氶崡鍐差嚕閺屻儱绠瑰ù锝呮贡閸樻悂姊虹粙鎸庢拱闁挎岸鏌嶈閸撴岸鎮у鍫濈劦妞ゆ帊娴囨竟妯肩磽瀹ュ拑韬€殿喖顭锋俊鎼佸煛閸屾矮绨婚梻浣告啞缁嬫垿鏁冮敂钘夘嚤闁告洦鍨遍埛?
		{
	 		SDIO_ClearFlag(SDIO_FLAG_STBITERR);//闂傚倸鍊搁崐宄懊归崶褉鏋栭柡鍥ュ灩缁愭鏌熼悧鍫熺凡闁告垹濮撮埞鎴︽偐鐎圭姴顥濈紓浣哄閸ㄥ爼寮婚敐澶婄闁挎繂鎲涢幘缁樼厸闁告侗鍠楅崐鎰版煛瀹€瀣瘈鐎规洘甯掕灒閻炴稈鈧厖澹曢梺鍝勭▉閸嬧偓闁稿鎸搁～婵嬵敆閸屾簽銊╂⒑閸濆嫯顫﹂柛鏃€鍨块獮鍐閵堝懎绐涙繝鐢靛Т鐎氼亞妲愰弴銏♀拻濞达絿鍎ら崵鈧梺鎼炲灪閻撯€崇暦閺屻儲鍤戞い鎺嶇鎼?
			return SD_START_BIT_ERR;		 
		}  
   SDIO_ClearFlag(SDIO_STATIC_FLAGS);//闂傚倸鍊搁崐宄懊归崶褉鏋栭柡鍥ュ灩缁愭鏌熼悧鍫熺凡闁告垹濮撮埞鎴︽偐鐎圭姴顥濈紓浣哄閸ㄥ爼寮婚敐澶婄闁挎繂鎲涢幘缁樼厸闁告侗鍠楅崐鎰版煛瀹€瀣瘈鐎规洘甯掕灒閻炴稈鈧厖澹曢梺鍝勭▉閸嬧偓闁稿鎸搁～婵嬵敆閸屾簽銊╂⒑閸濆嫯顫﹂柛鏃€鍨块獮鍐閵堝懎绐涙繝鐢靛Т鐎氼亞妲愰弴銏♀拻濞达絽鎲＄拹锟犳煕韫囨棑鑰跨€殿喓鍔戦弻鍡楊吋閸涱厼娈ら梻浣稿暱閹碱偊骞婅箛娑欏亗闁靛鏅滈悡鐔兼煛閸屾稑顕滈柛鐔哄仱閺岋綀绠涢敐鍛彎闂?
	//闂傚倸鍊搁崐宄懊归崶褉鏋栭柡鍥ュ灩缁愭鏌熼悧鍫熺凡闁告垹濮撮埞鎴︽偐鐎圭姴顥濈紓浣哄閸ㄥ爼寮婚敐澶婄闁挎繂鎲涢幘缁樼厸闁告侗鍠楅崐鎰版煛瀹€瀣瘈鐎规洘甯掕灒閻炴稈鈧厖澹曢梺鍝勭▉閸嬧偓闁稿鎸搁～婵嬵敆閸屾簽銊╂⒑閸濆嫯顫﹂柛鏃€鍨块獮鍐閵堝懎绐涙繝鐢靛Т鐎氼亞妲愰弴銏♀拻濞达絽鎽滅粔鐑樸亜閵夛附宕岀€规洘顨呴～婊堝焵椤掍椒绻嗛悗娑櫳戦崕鐔兼煏婵犲繐顩柛娆忔濮婅櫣绱掑Ο鑽ゅ弳闂佺顕滅换婵嬪箖濮椻偓椤㈡岸鍩€椤掑嫬钃?濠电姷鏁搁崑鐘诲箵椤忓棗绶ら柣锝呯灱閻挾鈧娲栧ú锔锯偓姘煼閺岋綁寮崹顔藉€梺缁樻尪閸庣敻寮婚敐澶婃闁圭楠搁弳鍫ユ⒑鐠囧弶绂嬮柛锝忕秮瀵鎮㈤崗鐓庝痪濡炪倖鐗楃粙鏍触閸屾粎纾介柛灞炬皑瀛濋梺纭呮珪閿曘垹顕ｆ繝姘╅柍鍝勫€告禍婊堟⒑閸涘﹦鈽夐柨鏇檮鐎靛ジ宕熼娑掓嫼閻熸粎澧楃敮鈺佄涢幋锔界厱闊洦妫戦懓璺ㄢ偓娈垮櫘閸嬪﹪鐛Ο鍏煎珰闁告瑥顦藉Λ鐔兼⒒娓氣偓濞佳囨偋閸℃あ娑樜旈崪浣规櫆闂佸壊鍋呭ú姗€鍩涢幋锔藉仯闁诡厽甯掓俊濂告煛鐎ｎ偄鐏撮柡宀嬬磿閳ь剨缍嗘禍鍫曟偂閸忕⒈娈?   	
	*(pscr+1)=((tempscr[0]&SD_0TO7BITS)<<24)|((tempscr[0]&SD_8TO15BITS)<<8)|((tempscr[0]&SD_16TO23BITS)>>8)|((tempscr[0]&SD_24TO31BITS)>>24);
	*(pscr)=((tempscr[1]&SD_0TO7BITS)<<24)|((tempscr[1]&SD_8TO15BITS)<<8)|((tempscr[1]&SD_16TO23BITS)>>8)|((tempscr[1]&SD_24TO31BITS)>>24);
 	return errorstatus;
}
//闂傚倸鍊搁崐宄懊归崶褉鏋栭柡鍥ュ灩缁愭鏌熼崜褏甯涢柛瀣€归妵鍕箛閳轰讲鍋撻弴銏犲嚑闁割偅绻嶉悢鍡涙偣鏉炴媽顒熼柛搴＄箲閵囧嫯绠涢弴鍐╁ТmberOfBytes闂傚倸鍊搁崐宄懊归崶褉鏋栭柡鍥ュ灩缁愭鏌熼悧鍫熺凡闁告垹濮撮埞鎴︽偐鐎圭姴顥濈紓?濠电姷鏁搁崑鐐哄垂閸洖绠伴悹鍥ф▕濞撹霉閻樺樊鍎忛柡瀣╃窔閺岀喖宕滆鐢盯鏌嶉柨瀣磳闁哄本鐩獮姗€鎳犻鍐崶闂備礁鎼Λ娆戝垝閹捐钃熼柣鏂垮悑閸婂鏌ら幁鎺戝姕闁哄棛濞€閺岋絾鎯旈敍鍕驳閻庡厜鍋撻柟闂寸閽冪喖鏌曟繛鐐珕闁稿瀚伴弻娑樷槈濮楀牆濮涙繛瀵稿帶鐎氭澘顫?
//NumberOfBytes:闂傚倸鍊搁崐宄懊归崶褉鏋栭柡鍥ュ灩缁愭鏌￠崶鑸靛▏闁逞屽厸缁€渚€鈥﹂妸鈺侀唶婵犻潧娴傚Λ鐔兼⒒娓氣偓濞佳囨偋閸℃あ娑樜旈崪浣规櫆闂佸壊鍋呭ú姗€鍩涢幋锔藉仯闁诡厽甯掓俊濂告煛鐎ｎ偄鐏撮柡宀嬬磿閳ь剨缍嗘禍鍫曟偂閸忕⒈娈?
//闂傚倸鍊搁崐宄懊归崶褉鏋栭柡鍥ュ灩缁愭鏌熼悧鍫熺凡闁告垹濮撮埞鎴︽偐鐎圭姴顥濈紓浣哄閸ㄥ爼寮婚敐澶婄闁挎繂鎲涢幘缁樼厸闁告侗鍠楅崐鎰版煛瀹€瀣瘈鐎规洘甯掕灒閻炴稈鈧厖澹曢梺鍝勭▉閸嬧偓闁稿鎸搁～婵嬵敆閸屾簽銊╂倵?闂傚倸鍊搁崐宄懊归崶褉鏋栭柡鍥ュ灩缁愭鏌熼悧鍫熺凡闁告垹濮撮埞鎴︽偐鐎圭姴顥濈紓?濠电姷鏁搁崑鐐哄垂閸洖绠伴悹鍥ф▕濞撹霉閻樺樊鍎忛柡瀣╃窔閺岀喖宕滆鐢盯鏌嶉柨瀣磳闁哄本鐩獮姗€鎳犻鍐崶闂備礁鎼Λ娆戝垝閹捐钃熼柣鏂垮悑閸婂鏌ら幁鎺戝姕闁哄棛濞€閺岋絾鎯旈敍鍕驳閻庡厜鍋撻柟闂寸閽冪喖鏌曟繛鐐珕闁稿瀚伴弻娑樷槈濮楀牆濮涙繛瀵稿帶鐎氭澘顫忓ú顏呭仭闁哄瀵т簺闂備焦鎮堕崹娲偂閿熺姴鏄ラ柍?
u8 convert_from_bytes_to_power_of_two(u16 NumberOfBytes)
{
	u8 count=0;
	while(NumberOfBytes!=1)
	{
		NumberOfBytes>>=1;
		count++;
	}
	return count;
} 	 

//闂傚倸鍊搁崐宄懊归崶褉鏋栭柡鍥ュ灩缁愭鏌熼悧鍫熺凡闁告垹濮撮埞鎴︽偐鐎圭姴顥濈紓浣哄閸ㄥ爼寮婚敐澶婄闁挎繂鎲涢幘缁樼厸闁告侗鍠楅崐鎰版煛瀹€瀣瘈鐎规洘甯掕灒閻炴稈鈧厖澹曢梺鍝勭▉閸嬧偓闁稿鎸搁～婵囨綇閳哄倹鍟滵IO DMA  
//mbuf:闂傚倸鍊搁崐宄懊归崶褉鏋栭柡鍥ュ灩缁愭鏌￠崶鈺佹瀾闁告瑥绻橀弻鏇㈠醇濠垫劖笑缂佺偓鍎抽妶鎼佸蓟閺囩喓绠鹃柣鎰靛墯閻濇洟姊洪崫鍕櫤闁诡喖鍊垮濠氭晸閻樿尙锛滃┑鈽嗗灥閵嗏偓闁稿鎹囧浠嬵敃閻旇渹澹曞┑顔斤供閸撴稓绮斿ú顏呯厸閻忕偠顕ф慨鍌炴煙椤斿搫鐏茬€规洏鍔嶇换婵嬪礋椤忓棛锛熼梻鍌氬€烽懗鍫曞箠閹捐搴婇柡灞诲劚鎼村﹪鏌熺紒妯轰刊闁?
//bufsize:闂傚倸鍊搁崐宄懊归崶褉鏋栭柡鍥ュ灩缁愭鏌熼悧鍫熺凡闁告垹濮撮埞鎴︽偐鐎圭姴顥濈紓浣哄閸ㄥ爼寮婚敐澶婄闁挎繂鎲涢幘缁樼厸闁告侗鍠楅崐鎰版煛瀹€瀣瘈鐎规洘甯掕灒閻炴稈鈧厖澹曢梺鍝勭▉閸嬧偓闁稿鎸搁～婵嬵敆閸屾簽銊╂⒑閸濆嫯顫﹂柛鏃€鍨块獮鍐閵堝懎绐涙繝鐢靛Т鐎氼亞妲愰弴銏♀拻濞达絽鎽滅粔鐑樸亜閵夛附宕岀€规洘顨呴～婊堝焵椤掆偓椤曪綁顢曢敃鈧粻濠氭偣閸パ冪骇妞ゃ儲绻堝娲濞戞艾顣哄┑鈽嗗亝椤ㄥ﹪銆侀弮鍫濋唶闁哄洨鍟块幏娲煟閻樺厖鑸柛鏂跨焸瀵悂骞嬮敂鐣屽幐闁诲函缍嗘禍鍫曟偂閸忕⒈娈?
//dir:闂傚倸鍊搁崐宄懊归崶褉鏋栭柡鍥ュ灩缁愭鏌熼悧鍫熺凡闁告垹濮撮埞鎴︽偐鐎圭姴顥濈紓浣哄閸ㄥ爼寮婚敐澶婄闁挎繂鎲涢幘缁樼厸闁告侗鍠楅崐鎰版煛瀹€瀣瘈鐎规洘甯掕灒閻炴稈鈧厖澹曢梺鍝勭▉閸嬧偓闁?DMA_DIR_MemoryToPeripheral  闂傚倸鍊搁崐宄懊归崶褉鏋栭柡鍥ュ灩缁愭鏌￠崶鈺佹瀾闁告瑥绻橀弻鏇㈠醇濠垫劖笑缂佺偓鍎抽妶鎼佸蓟閺囩喓绠鹃柣鎰靛墯閻濇洟姊洪崫鍕櫤闁诡喖鍊垮濠氭晸閻樿尙锛滃┑鈽嗗灥閵嗏偓闁稿鎹囧浠嬵敃閻旇渹澹?->SDIO(闂傚倸鍊风粈渚€骞夐敓鐘茬闁哄稁鍘介崑锟犳煃閸濆嫭鍣归柡瀣╃窔閺岀喖骞戦幇闈涙濠碘槅鍋呴敃銏ゅ蓟閺囥垹閱囨繝闈涙祩濡偛顪冮妶鍛闁绘牜鍘ч～蹇涙惞鐟欏嫬纾梺闈涱焾閸庢煡鎮楁ィ鍐┾拺闁告繂瀚烽崕蹇斻亜椤撶姴鍘撮柣?;DMA_DIR_PeripheralToMemory SDIO-->闂傚倸鍊搁崐宄懊归崶褉鏋栭柡鍥ュ灩缁愭鏌￠崶鈺佹瀾闁告瑥绻橀弻鏇㈠醇濠垫劖笑缂佺偓鍎抽妶鎼佸蓟閺囩喓绠鹃柣鎰靛墯閻濇洟姊洪崫鍕櫤闁诡喖鍊垮濠氭晸閻樿尙锛滃┑鈽嗗灥閵嗏偓闁稿鎹囧浠嬵敃閻旇渹澹?闂傚倸鍊搁崐宄懊归崶褉鏋栭柡鍥ュ灩缁愭鏌熼悧鍫熺凡闁告垹濮撮埞鎴︽偐鐎圭姴顥濈紓浣哄閸ㄥ爼寮婚敐澶婄闁挎繂鎲涢幘缁樼厸闁告侗鍠楅崐鎰版煛瀹€瀣瘈鐎规洘甯掕灒閻炴稈鈧厖澹曢梺鍝勭▉閸嬧偓闁稿鎸搁～婵嬵敆閸屾簽銊╂⒑閸濆嫯顫﹂柛鏃€鍨块獮鍐閵堝懎绐涙繝鐢靛Т鐎氼亞妲愰弴銏♀拻?;
void SD_DMA_Config(u32*mbuf,u32 bufsize,u32 dir)
{		 

  DMA_InitTypeDef  DMA_InitStructure;
	
	while (DMA_GetCmdStatus(DMA2_Stream3) != DISABLE){}//闂傚倸鍊搁崐宄懊归崶褉鏋栭柡鍥ュ灩缁愭鏌″搴″箹閸ユ挳姊虹紒妯虹仸閽冭京绱撳鍛枠闁哄矉缍侀獮鍥濞戞﹩娼绘俊鐐€曠换鎺椼€呯化鎻傞梻鍌氬€搁崐宄懊归崶褉鏋栭柡鍥ュ灩缁愭鏌熼悧鍫熺凡闁告垹濮撮埞鎴︽偐鐎圭姴顥濈紓浣哄閸ㄥ爼寮婚敐澶婄闁挎繂鎲涢幘缁樼厸闁告侗鍠楅崐鎰版煛瀹€瀣瘈鐎规洘甯掕灒閻炴稈鈧厖澹曢梺鍝勭▉閸嬧偓闁稿鎸搁～婵嬵敆閸屾簽銊╂⒑閸濆嫯顫﹂柛鏃€鍨块獮鍐閵堝懎绐涙繝鐢靛Т鐎氼亞妲愰弴銏♀拻?
		
  DMA_DeInit(DMA2_Stream3);//闂傚倸鍊搁崐宄懊归崶褉鏋栭柡鍥ュ灩缁愭鏌熼悧鍫熺凡闁告垹濮撮埞鎴︽偐鐎圭姴顥濈紓浣哄閸ㄥ爼寮婚敐澶婄闁挎繂鎲涢幘缁樼厸闁告侗鍠楅崐鎰版煙椤旀寧纭鹃柍钘夘槸閳诲骸螣濞茶鎮呴梻鍌欑閹芥粓宕伴幇顒夋僵闁靛ň鏅涢弸浣广亜閺囨浜惧銈冨灪閻熲晠骞愭繝鍐ㄧ窞婵☆垰婀辨径鍕⒒閸屾艾鈧嘲霉閸パ€鏋栭柡鍥ュ灩缁愭鏌熼悙顒€澧繛灏栨櫊閺岋綁鏁愰崨顐熷亾瀹稿潊m3闂傚倸鍊搁崐宄懊归崶褉鏋栭柡鍥ュ灩缁愭鏌￠崶鈺佇ｆい鎰Г缁绘繈妫冨☉姘暫闂佸搫顑呴悧鍡涒€︾捄銊﹀磯濞撴凹鍨伴崜鏉款渻閵堝懐绠伴柣鏍帶椤繘鎼圭憴鍕／闂侀潧顭堥崕鏌ユ倵妤ｅ啯鈷戦柛婵嗗閸庡繑銇勯鐘插幋闁绘侗鍠涚粻娑樷槈濞嗗繆鍋撴繝姘厾闁诡厽甯掗崝婊勭箾閸涱偄鐏叉慨濠冩そ瀹曨偊宕熼鐔蜂壕闁割偅娲栫壕褰掓煛瀹ュ骸浜愰柛瀣尭椤繈顢楅崒婧炪劑姊洪崫鍕潶闁告梹鍨块獮鍐閻樺灚娈濋梺鍝勵槼濞夋洜妲愰敃鍌涒拻濞达絽鎲￠幆鍫ユ煕鐎ｎ亝顥㈢€规洏鍨虹粋鎺斺偓锝庝海閸╃偞绻濋悽闈浶ｉ柤鐟板⒔缁顢涘┃鎯т壕闁荤喐婢橀顏勵熆閻熺増顥犵紒?
	
 
  DMA_InitStructure.DMA_Channel = DMA_Channel_4;  //闂傚倸鍊搁崐椋庢閿熺姴纾婚柛娑卞幘閺嗗棝鏌熼梻瀵割槮闁哄绶氶弻鐔煎箲閹伴潧娈┑鈽嗗亝閿曘垽寮婚弴銏犻唶婵犻潧娴傚Λ鐐差渻閵堝懐绠伴柣鏍帶椤繐煤椤忓秵鏅濋梺闈涚箚閺呮粓鍩㈤崼銉︹拺閺夌偞澹嗛崝宥夋煙閻熺増鎼愭い鏇秮椤㈡宕熼瀣斿洦鐓曢柍鈺佸枤濞堛垹霉?
  DMA_InitStructure.DMA_PeripheralBaseAddr = (u32)&SDIO->FIFO;//DMA闂傚倸鍊搁崐宄懊归崶褉鏋栭柡鍥ュ灩缁愭鏌熼悧鍫熺凡闁告垹濮撮埞鎴︽偐鐎圭姴顥濈紓浣哄閸ㄥ爼寮婚敐澶婄闁挎繂鎲涢幘缁樼厸闁告侗鍠楅崐鎰版煛瀹€瀣瘈鐎规洘甯掕灒閻炴稈鈧厖澹曢梺鍝勭▉閸嬧偓闁稿鎸搁～婵嬵敆閸屾簽銊╂⒑閸濆嫯顫﹂柛鏃€鍨块獮鍐閻樺棜娅ｇ槐鎺懳熺紒妯煎将?
  DMA_InitStructure.DMA_Memory0BaseAddr = (u32)mbuf;//DMA 闂傚倸鍊搁崐宄懊归崶褉鏋栭柡鍥ュ灩缁愭鏌￠崶鈺佹瀾闁告瑥绻橀弻鏇㈠醇濠垫劖笑缂佺偓鍎抽妶鎼佸蓟閺囩喓绠鹃柣鎰靛墯閻濇洟姊洪崫鍕櫤闁诡喖鍊垮濠氭晸閻樿尙锛滃┑鈽嗗灥閵嗏偓闁稿鎹囧浠嬵敃閻旇渹澹?闂傚倸鍊搁崐宄懊归崶褉鏋栭柡鍥ュ灩缁愭鏌熼悧鍫熺凡闁告垹濮撮埞鎴︽偐鐎圭姴顥濈紓浣哄閸ㄦ娊鍩€椤掑倹鍤€閻庢凹鍠楅弲璺何旈崘銊х瓘?
  DMA_InitStructure.DMA_DIR = dir;//闂傚倸鍊搁崐宄懊归崶褉鏋栭柡鍥ュ灩缁愭鏌￠崶鈺佹瀾闁告瑥绻橀弻鏇㈠醇濠垫劖笑缂佺偓鍎抽妶鎼佸蓟閺囩喓绠鹃柣鎰靛墯閻濇洟姊洪崫鍕櫤闁诡喖鍊垮濠氭晸閻樿尙锛滃┑鈽嗗灥閵嗏偓闁稿鎹囧浠嬵敃閻旇渹澹曞┑顔斤供閸撴稓绮斿ú顏呯厸閻忕偠顕ф慨鍌炴煙椤斿搫鐏茬€规洏鍔嶇换婵嬪礋椤忓棛锛熼梻鍌氬€风粈浣虹礊婵犲泚澶愬箻鐠囪尙顦у┑顔姐仜閸嬫挾鈧鍣崑濠囩嵁濡吋瀚氶柛娆忣樈濡喖姊绘笟鈧褔鎮ч崱妞㈡稑螖閸滀焦鏅滈梺鍓插亝濞叉﹢鍩涢幋锔藉仯闁诡厽甯掓俊濂告煛鐎ｎ偄鐏撮柡宀嬬磿閳ь剨缍嗘禍鍫曟偂閸忕⒈娈介柣鎰皺缁犲鏌＄仦璇插闁逞屽墾缁茶棄螞閺冨倻鐭嗗〒姘ｅ亾妞?
  DMA_InitStructure.DMA_BufferSize = 0;//闂傚倸鍊搁崐宄懊归崶褉鏋栭柡鍥ュ灩缁愭鏌熼悧鍫熺凡闁告垹濮撮埞鎴︽偐鐎圭姴顥濈紓浣哄閸ㄥ爼寮婚敐澶婄闁挎繂鎲涢幘缁樼厸闁告侗鍠楅崐鎰版煛瀹€鈧崰鏍х暦閻戠瓔鏁囬柣鏂挎惈婵粙姊绘担绛嬫綈婵＄偞瀵х粋宥夘敂閸垹绁﹂棅顐㈡处缁嬫帡宕愭繝姘厾闁诡厽甯掗崝婊勭箾閸涱偄鐏叉慨濠冩そ瀹曨偊宕熼鐔蜂壕闁割偅娲栫壕褰掓煛瀹ュ骸浜愰柛瀣尭椤繈顢楅崒婧炪劑姊洪崫鍕潶闁告梹鍨块獮鍐閵堝懎绐涙繝鐢靛Т鐎氼亞妲愰弴銏♀拻?
  DMA_InitStructure.DMA_PeripheralInc = DMA_PeripheralInc_Disable;//闂傚倸鍊搁崐宄懊归崶褉鏋栭柡鍥ュ灩缁愭鏌熼悧鍫熺凡闁告垹濮撮埞鎴︽偐鐎圭姴顥濈紓浣哄閸ㄥ爼寮婚敐澶婄闁挎繂鎲涢幘缁樼厸闁告侗鍠楅崐鎰版煛瀹€瀣瘈鐎规洘甯掕灒閻炴稈鈧厖澹曢梺鍝勭▉閸嬧偓闁稿鎸搁～婵嬵敆閸屾簽銊╂⒑閸濆嫯顫﹂柛鏃€鍨块獮鍐閵堝懎绐涙繝鐢靛Т鐎氼亞妲愰弴銏♀拻濞达絽鎽滅粔鐑樸亜閵夛附宕岀€规洘顨呴～婊堝焵椤掆偓椤曪綁顢曢敃鈧粻濠氭偣閸パ冪骇妞ゃ儲绻堝娲濞戞艾顣哄┑鈽嗗亝椤ㄥ﹪銆侀弮鍫濋唶闁哄洨鍟块幏娲煟閻樺厖鑸柛鏂跨焸瀵顓兼径瀣幘闂佺粯鎸搁柊锝夊矗閸曨垱鐓?
  DMA_InitStructure.DMA_MemoryInc = DMA_MemoryInc_Enable;//闂傚倸鍊搁崐宄懊归崶褉鏋栭柡鍥ュ灩缁愭鏌￠崶鈺佹瀾闁告瑥绻橀弻鏇㈠醇濠垫劖笑缂佺偓鍎抽妶鎼佸蓟閺囩喓绠鹃柣鎰靛墯閻濇洟姊洪崫鍕櫤闁诡喖鍊垮濠氭晸閻樿尙锛滃┑鈽嗗灥閵嗏偓闁稿鎹囧浠嬵敃閻旇渹澹曞┑顔斤供閸撴稓绮斿ú顏呯厸閻忕偠顕ф慨鍌炴煙椤斿搫鐏茬€规洏鍔嶇换婵嬪礋椤忓棛锛熼梻鍌氬€风粈浣虹礊婵犲泚澶愬箻鐠囪尙顦у┑顔姐仜閸嬫挾鈧鍣崑濠囩嵁濡吋瀚氶柛娆忣樈濡喖姊绘笟鈧褔鎮ч崱妞㈡稑螖閸滀焦鏅滈梺鑲╊焾閸氣偓缂佽妫欓妵鍕冀閵婏絼绮堕梺绋款儐閹告悂鎮鹃悜钘夌倞闁冲搫锕ラ弫?
  DMA_InitStructure.DMA_PeripheralDataSize = DMA_PeripheralDataSize_Word;//闂傚倸鍊搁崐宄懊归崶褉鏋栭柡鍥ュ灩缁愭鏌熼悧鍫熺凡闁告垹濮撮埞鎴︽偐鐎圭姴顥濈紓浣哄閸ㄥ爼寮婚敐澶婄闁挎繂鎲涢幘缁樼厸闁告侗鍠楅崐鎰版煛瀹€瀣瘈鐎规洘甯掕灒閻炴稈鈧厖澹曢梺鍝勭▉閸嬧偓闁稿鎸搁～婵嬵敆閸屾簽銊╂⒑閸濆嫯顫﹂柛鏃€鍨块獮鍐閵堝懎绐涙繝鐢靛Т鐎氼亞妲愰弴銏♀拻濞达絽鎽滅粔鐑樸亜閵夛附宕岀€规洘顨呴～婊堝焵椤掆偓椤曪綁顢曢敃鈧粻濠氭偣閸ヮ亜鐨烘い鏂款槹娣囧﹪鎮欏顔煎壈闁诲骸鐏氱敮鈥崇暦濠靛棭鐓ラ柛顐ゅ枔閸樺灚淇婇悙宸剰濡ょ姵鎮傚畷銏ゅ箻椤旂晫鍘告繛杈剧秬椤鐣峰畝鈧埀顒侇問閸ｎ噣宕滈悢闀愮箚闁割偅娲栭獮銏′繆閵堝拑姊楃紒?32濠?
  DMA_InitStructure.DMA_MemoryDataSize = DMA_MemoryDataSize_Word;//闂傚倸鍊搁崐宄懊归崶褉鏋栭柡鍥ュ灩缁愭鏌￠崶鈺佹瀾闁告瑥绻橀弻鏇㈠醇濠垫劖笑缂佺偓鍎抽妶鎼佸蓟閺囩喓绠鹃柣鎰靛墯閻濇洟姊洪崫鍕櫤闁诡喖鍊垮濠氭晸閻樿尙锛滃┑鈽嗗灥閵嗏偓闁稿鎹囧浠嬵敃閻旇渹澹曞┑顔斤供閸撴稓绮斿ú顏呯厸閻忕偠顕ф慨鍌炴煙椤斿搫鐏茬€规洏鍔嶇换婵嬪礋椤忓棛锛熼梻鍌氬€风粈浣虹礊婵犲泚澶愬箻鐠囪尙顦у┑顔姐仜閸嬫挾鈧鍣崑濠囩嵁濡吋瀚氶柤纰卞墻閸炵懓鈹戦敍鍕粶妞ゆ垵鎳愰埀顒€鐏氱敮鈥崇暦濠靛棭鐓ラ柛顐ゅ枔閸樺灚淇婇悙宸剰濡ょ姵鎮傚畷銏ゅ箻椤旂晫鍘告繛杈剧秬椤鐣峰畝鈧埀顒侇問閸ｎ噣宕滈悢闀愮箚闁割偅娲栭獮銏′繆閵堝拑姊楃紒?32濠?
  DMA_InitStructure.DMA_Mode = DMA_Mode_Normal;// 濠电姷鏁搁崑鐘诲箵椤忓棗绶ら柦妯侯樈閻掍粙鏌ㄩ悢鍝勑㈤柡瀣╃窔閺岀喖骞戦幇闈涙濠碘槅鍋呴敃銏ゅ蓟閺囥垹閱囨繝闈涙祩濡偛顪冮妶鍛闁绘牜鍘ч～蹇涙惞鐟欏嫬纾梺闈涱焾閸庢煡鎮楁ィ鍐┾拺闁告繂瀚烽崕蹇斻亜椤撶姴鍘撮柣娑卞枦缁犳稑鈽夊▎蹇婂亾婵犳碍鍋℃繛鍡樼懅閸掓澘霉濠婂懎浜鹃柟渚垮妼椤粓宕卞Δ鈧濠电偠鎻徊鑺ョ珶婵犲洤鍚?
  DMA_InitStructure.DMA_Priority = DMA_Priority_VeryHigh;//闂傚倸鍊搁崐宄懊归崶褉鏋栭柡鍥ュ灩缁愭鏌熼悧鍫熺凡闁告垹濮撮埞鎴︽偐鐎圭姴顥濈紓浣哄閸ㄥ爼寮婚敐澶婄闁挎繂鎲涢幘缁樼厸闁告侗鍠楅崐鎰版煛瀹€瀣瘈鐎规洘甯掕灒閻炴稈鈧厖澹曢梺鍝勭▉閸嬧偓闁稿鎸搁～婵嬵敆閸屾簽銊╂⒑閸濆嫯顫﹂柛鏃€鍨块獮鍐閵堝懎绐涙繝鐢靛Т鐎氼亞妲愰弴銏♀拻濞达絽鎲＄拹锟犳煕韫囨棑鑰块挊鐔兼煙閹规劦鍤欓梻鍌ゅ灣閹叉悂寮崼婵婃憰?
  DMA_InitStructure.DMA_FIFOMode = DMA_FIFOMode_Enable;   //FIFO濠电姷鏁搁崑鐘诲箵椤忓棗绶ら柦妯侯樈閻掍粙鏌ㄩ悢鍝勑㈤柡瀣╃窔閺岀喖骞戦幇闈涙濠碘槅鍋呴敃銏ゅ蓟閺囥垹閱囨繝闈涙祩濡偛顪?     
  DMA_InitStructure.DMA_FIFOThreshold = DMA_FIFOThreshold_Full;//闂傚倸鍊烽懗鍫曗€﹂崼銏″床闁糕剝绋戦悞鍨亜閹烘垵浜炴俊顖氭O
  DMA_InitStructure.DMA_MemoryBurst = DMA_MemoryBurst_INC4;//闂傚倸鍊搁崐宄懊归崶褉鏋栭柡鍥ュ灩缁愭鏌熼悧鍫熺凡闁告垹濮撮埞鎴︽偐鐎圭姴顥濈紓浣哄閸ㄥ爼寮婚敐澶婄闁挎繂鎲涢幘缁樼厸闁告侗鍠楅崐鎰版煛瀹€瀣瘈鐎规洘甯掕灒閻炴稈鈧厖澹曢梺鍝勭▉閸嬧偓闁稿鎸搁～婵嬵敆娴ｇ晫顢呯紓鍌欑贰閸ｎ垳寰婇崜褏绠旈柣鏃傚帶閻掑灚銇勯幒鎴濐仼闁哄绶氶弻鐔煎箲閹伴潧娈┑鈽嗗亝閿曘垽寮婚弴銏犻唶婵犻潧娴傚Λ鐐差渻?闂傚倸鍊搁崐宄懊归崶褉鏋栭柡鍥ュ灩缁愭鏌￠崶鈺佹灁缂佺娀绠栭弻娑㈠Ψ閿濆懎顬夌紓鍌氱Т濞差參寮婚敐澶婄疀闂傚牊绋戦～鈺侇渻閵堝懐绠伴柣鏍帶椤繘鎼圭憴鍕／闂侀潧顭堥崕鏌ユ倵妤ｅ啯鈷戦柛婵嗗閸庡繑銇勯鐘插幋闁?
  DMA_InitStructure.DMA_PeripheralBurst = DMA_PeripheralBurst_INC4;//闂傚倸鍊搁崐宄懊归崶褉鏋栭柡鍥ュ灩缁愭鏌￠崶鈺佹瀾闁告瑥绻橀弻鏇㈠醇濠垫劖笑缂佺偓鍎抽妶鎼佸蓟閺囩喓绠鹃柣鎰靛墯閻濇洟姊洪崫鍕櫤闁诡喖鍊垮濠氭晸閻樿尙锛滃┑鈽嗗灥閵嗏偓闁稿鎹囧浠嬵敃閻旇渹澹曞┑顔斤供閸撴氨鎷归敍鍕＜妞ゆ洖妫涚粙鑽ょ磼濡ゅ啫鏋涢柛鈹惧亾濡炪倖甯掔€氼剟寮告笟鈧弻鐔煎箲閹伴潧娈┑鈽嗗亝閿曘垽寮婚弴銏犻唶婵犻潧娴傚Λ鐐差渻?闂傚倸鍊搁崐宄懊归崶褉鏋栭柡鍥ュ灩缁愭鏌￠崶鈺佹灁缂佺娀绠栭弻娑㈠Ψ閿濆懎顬夌紓鍌氱Т濞差參寮婚敐澶婄疀闂傚牊绋戦～鈺侇渻閵堝懐绠伴柣鏍帶椤繘鎼圭憴鍕／闂侀潧顭堥崕鏌ユ倵妤ｅ啯鈷戦柛婵嗗閸庡繑銇勯鐘插幋闁?
  DMA_Init(DMA2_Stream3, &DMA_InitStructure);//闂傚倸鍊搁崐宄懊归崶褉鏋栭柡鍥ュ灩缁愭鏌熼悧鍫熺凡闁告垹濮撮埞鎴︽偐鐎圭姴顥濈紓浣哄閸ㄦ娊鍩€椤掑倹鍤€閻庢矮鍗冲畷鎴炵節閸屻倗鍔峰┑掳鍊曢幊蹇涘煕閹达附鍋ｉ柟顓熷笒婵″ジ鏌＄€ｎ偄鐏撮柡宀嬬磿閳ь剨缍嗘禍鍫曟偂閸忕⒈娈介柣鎰皺缁犲磭绱掗鐣屾噰閽樼喖鏌?Stream

	DMA_FlowControllerConfig(DMA2_Stream3,DMA_FlowCtrl_Peripheral);//闂傚倸鍊搁崐宄懊归崶褉鏋栭柡鍥ュ灩缁愭鏌熼悧鍫熺凡闁告垹濮撮埞鎴︽偐鐎圭姴顥濈紓浣哄閸ㄥ爼寮婚敐澶婄闁挎繂鎲涢幘缁樼厸闁告侗鍠楅崐鎰版煛瀹€瀣瘈鐎规洘甯掕灒閻炴稈鈧厖澹曢梺鍝勭▉閸嬧偓闁稿鎸搁～婵嬵敆閸屾簽銊╂⒑閸濆嫯顫﹂柛鏃€鍨块獮鍐閵堝懎绐涙繝鐢靛Т鐎氼亞妲愰弴銏♀拻濞达絽鎽滅粔鐑樸亜閵夛附宕岀€规洘顨呴～婊堝焵椤掆偓椤曪綁顢曢敃鈧粻濠氭偣閸パ冪骇妞ゃ儲绻堝娲濞戞艾顣哄┑鈽嗗亝椤ㄥ﹪銆侀弮鍫濋唶闁哄洨鍟块幏娲煟閻樺厖鑸柛鏂跨焸瀵悂骞嬮敂鐣屽幐闁诲函缍嗘禍鍫曟偂閸忕⒈娈?
	 
  DMA_Cmd(DMA2_Stream3 ,ENABLE);//闂傚倸鍊搁崐宄懊归崶褉鏋栭柡鍥ュ灩缁愭鏌熼悧鍫熺凡闁告垹濮撮埞鎴︽偐鐎圭姴顥濈紓浣哄閸ㄥ爼寮婚敐澶婄闁挎繂鎲涢幘缁樼厸闁告侗鍠楅崐鎰版煛瀹€瀣瘈鐎规洘甯掕灒閻炴稈鈧厖澹曢梺鍝勭▉閸嬧偓闁稿鎸搁～婵囶潙閺嵮冨MA闂傚倸鍊搁崐宄懊归崶褉鏋栭柡鍥ュ灩缁愭鏌熼悧鍫熺凡闁告垹濮撮埞鎴︽偐鐎圭姴顥濈紓浣哄閸ㄥ爼寮婚敐澶婄闁挎繂鎲涢幘缁樼厸闁告侗鍠楅崐鎰版煛瀹€瀣瘈鐎规洘甯掕灒閻炴稈鈧厖澹曢梺鍝勭▉閸嬧偓闁? 

}   


//闂傚倸鍊搁崐宄懊归崶褉鏋栭柡鍥ュ灩缁愭鏌熼悧鍫熺凡闁告垹濮撮埞鎴︽偐鐎圭姴顥濈紓浣哄閸ㄥ磭妲愰幒鏂哄亾閿濆骸澧婚柡鍡欏仱濮婂宕掑▎鎰偘濠电偛顦板ú鐔风暦娴兼潙绠涢柡澶婄仢閸ゆ垶绻濋悽闈浶ｉ柤鐟板⒔缁?
//buf:闂傚倸鍊搁崐宄懊归崶褉鏋栭柡鍥ュ灩缁愭鏌熼悧鍫熺凡闁告垹濮撮埞鎴︽偐鐎圭姴顥濈紓浣哄閸ㄥ爼寮婚敐澶婄闁挎繂鎲涢幘缁樼厸闁告侗鍠楅崐鎰版煛瀹€瀣瘈鐎规洘甯掕灒閻炴稈鈧厖澹曢梺鍝勭▉閸嬧偓闁稿鎸搁～婵嬵敆閸屾簽銊╂⒑閸濆嫯顫﹂柛鏃€鍨块獮鍐閵忋垻鐓撻柣鐘充航閸斿﹪宕戦敐鍛斀闁绘劕鐡ㄧ紞鎴︽煕濮橆剦鍎旈柟顔惧厴閺佸倿鏌ㄩ姘濠殿喗锕╅崜娑氱矓濞差亝鐓涢悘鐐额嚙婵倿鏌熼鍝勭伈鐎规洏鍔嶇换婵嬪礋椤忓棛锛熼梻鍌氬€风粈浣虹礊婵犲泚澶愬箻鐠囪尙顦у┑顔姐仜閸嬫挾鈧鍣崑濠囩嵁濡吋瀚氶柛娆忣樈濡喖姊绘笟鈧褔鎮ч崱妞㈡稑螖閸滀焦鏅?
//sector:闂傚倸鍊搁崐宄懊归崶褉鏋栭柡鍥ュ灩缁愭鏌熼悧鍫熺凡闁告垹濮撮埞鎴︽偐鐎圭姴顥濈紓浣哄閸ㄥ爼寮婚敐澶婄闁挎繂鎲涢幘缁樼厸闁告侗鍠楅崐鎰版煛瀹€瀣瘈鐎规洘甯掕灒閻炴稈鈧厖澹曢梺鍝勭▉閸嬧偓闁稿鎸搁～婵嬵敆閸屾簽銊╂⒑閸濆嫯顫﹂柛鏃€鍨块獮鍐閵堝懎绐涙繝鐢靛Т鐎氼亞妲愰弴銏♀拻濞达絿鍎ら崵鈧梺鎼炲灪閻撯€崇暦閺屻儱绠甸柟鐑樼箘閸?
//cnt:闂傚倸鍊搁崐宄懊归崶褉鏋栭柡鍥ュ灩缁愭鏌熼悧鍫熺凡闁告垹濮撮埞鎴︽偐鐎圭姴顥濈紓浣哄閸ㄥ爼寮婚敐澶婄闁挎繂鎲涢幘缁樼厸闁告侗鍠楅崐鎰版煛瀹€瀣瘈鐎规洘甯掕灒閻炴稈鈧厖澹曢梺鍝勭▉閸嬧偓闁稿鎸搁～婵嬵敆閸屾簽銊╂⒑閸濆嫯顫﹂柛鏃€鍨块獮鍐閵堝懎绐涙繝鐢靛Т鐎氼亞妲愰弴銏♀拻濞达絽鎽滅粔鐑樸亜閵夛附宕岀€规洘顨呴～婊堝焵椤掆偓椤曪綁顢曢敃鈧粻濠氭偣閸パ冪骇妞ゃ儲绻堝娲濞戞艾顣哄┑鈽嗗亝椤ㄥ﹪銆?
//闂傚倸鍊搁崐宄懊归崶褉鏋栭柡鍥ュ灩缁愭鏌熼悧鍫熺凡闁告垹濮撮埞鎴︽偐鐎圭姴顥濈紓浣哄閸ㄥ爼寮婚敐澶婄闁挎繂鎲涢幘缁樼厸闁告侗鍠楅崐鎰版煛瀹€瀣瘈鐎规洘甯掕灒閻炴稈鈧厖澹曢梺鍝勭▉閸嬧偓闁稿鎸搁～婵嬵敆閸屾簽銊╂倵?闂傚倸鍊搁崐宄懊归崶褉鏋栭柡鍥ュ灩缁愭鏌熼悧鍫熺凡闁告垹濮撮埞鎴︽偐鐎圭姴顥濈紓浣哄閸ㄥ爼寮婚敐澶婄闁挎繂鎲涢幘缁樼厸闁告侗鍠楅崐鎰版煛瀹€瀣瘈鐎规洘甯掕灒閻炴稈鈧厖澹曢梺鍝勭▉閸嬧偓闁稿鎸搁～婵嬵敆閸屾簽銊╂⒑鐠団€虫灀闁哄懐濞€楠炲﹤顭ㄩ崨顓熺€冲┑鈽嗗灥濡椼劍绔?0,闂傚倸鍊搁崐宄懊归崶褉鏋栭柡鍥ュ灩缁愭鏌熼悧鍫熺凡闁告垹濮撮埞鎴︽偐鐎圭姴顥濈紓浣哄閸ㄥ爼寮婚敐澶婄闁挎繂鎲涢幘缁樼厸闁告侗鍠楅崐鎰版煛瀹€瀣瘈鐎规洘甯掕灒閻炴稈鈧厖澹曢梺鍝勭▉閸嬧偓闁?闂傚倸鍊搁崐宄懊归崶褉鏋栭柡鍥ュ灩缁愭鏌熼悧鍫熺凡闁告垹濮撮埞鎴︽偐鐎圭姴顥濈紓浣哄閸ㄥ爼寮婚敐澶婄闁挎繂鎲涢幘缁樼厸闁告侗鍠楅崐鎰版煛瀹€瀣瘈鐎规洘甯掕灒閻炴稈鈧厖澹曢梺鍝勭▉閸嬧偓闁?闂傚倸鍊搁崐宄懊归崶褉鏋栭柡鍥ュ灩缁愭鏌熼悧鍫熺凡闁告垹濮撮埞鎴︽偐鐎圭姴顥濈紓浣哄閸ㄥ爼寮婚敐澶婄闁挎繂鎲涢幘缁樼厸闁告侗鍠楅崐鎰版煛瀹€瀣瘈鐎规洘甯掕灒閻炴稈鈧厖澹曢梺鍝勭▉閸嬧偓闁稿鎸搁～婵嬵敆閸屾簽銊╂⒑閸濆嫯顫﹂柛鏃€鍨块獮鍐閵堝懎绐涙繝鐢靛Т鐎氼亞妲愰弴銏♀拻濞达絽鎽滅粔鐑樸亜閵夛附宕岀€规洘顨呴～婊堝焵椤掆偓椤?				  				 
u8 SD_ReadDisk(u8*buf,u32 sector,u8 cnt)
{
	u8 sta=SD_OK;
	long long lsector=sector;
	u8 n;
	lsector<<=9;
	if((u32)buf%4!=0)
	{
	 	for(n=0;n<cnt;n++)
		{
		 	sta=SD_ReadBlock(SDIO_DATA_BUFFER,lsector+512*n,512);//闂傚倸鍊搁崐宄懊归崶褉鏋栭柡鍥ュ灩缁愭鏌熼悧鍫熺凡闁告垹濮撮埞鎴︽偐鐎圭姴顥濈紓浣哄閸ㄥ爼寮婚敐澶婄闁挎繂鎲涢幘缁樼厸闁告侗鍠楅崐鎰版煛瀹€瀣瘈鐎规洘甯掕灒閻炴稈鈧厖澹曢梺鍝勭▉閸嬧偓闁稿鎸搁～婵囨綇閳哄倹鐣絜ctor闂傚倸鍊搁崐宄懊归崶褉鏋栭柡鍥ュ灩缁愭鈧箍鍎遍ˇ浼村吹閹达箑绠归弶鍫濆⒔缁嬭鈹戦姘ュ仮闁诡喖鍢查埢搴ょ疀閹垮啩鎮ｆ俊鐐€曠换鎰版偉閻撳寒娼栭柧蹇氼潐瀹曞鏌曟繛鍨姕闁诲酣绠栧娲传閸曢潧鍓板銈庡幘閸忔﹢鎮伴璺ㄧ杸婵炴垶鐟ラ埀顒€顭烽弻銈夊箒閹烘垵濮曞┑鐐叉噷閸ㄨ棄顫忓ú顏勪紶闁告洦鍋€閸嬫捇宕奸弴鐐碉紮闂佸搫绋侀崑鈧柛?
			memcpy(buf,SDIO_DATA_BUFFER,512);
			buf+=512;
		} 
	}else
	{
		if(cnt==1)sta=SD_ReadBlock(buf,lsector,512);    	//闂傚倸鍊搁崐宄懊归崶褉鏋栭柡鍥ュ灩缁愭鏌熼悧鍫熺凡闁告垹濮撮埞鎴︽偐鐎圭姴顥濈紓浣哄閸ㄥ爼寮婚敐澶婄闁挎繂鎲涢幘缁樼厸闁告侗鍠楅崐鎰版煛瀹€瀣瘈鐎规洘甯掕灒閻炴稈鈧厖澹曢梺鍝勭▉閸嬧偓闁稿鎸搁～婵囨綇閳哄倹鐣絜ctor闂傚倸鍊搁崐宄懊归崶褉鏋栭柡鍥ュ灩缁愭鈧箍鍎遍ˇ浼村吹閹达箑绠归弶鍫濆⒔缁嬭鈹戦姘ュ仮闁诡喖鍢查埢搴ょ疀閹垮啩鎮ｆ俊鐐€曠换鎰版偉閻撳寒娼栭柧蹇氼潐瀹曞鏌曟繛鍨姕闁诲酣绠栧娲传閸曢潧鍓板銈庡幘閸忔﹢鎮伴璺ㄧ杸婵炴垶鐟ラ埀顒€顭烽弻銈夊箒閹烘垵濮曞┑鐐叉噷閸ㄨ棄顫忓ú顏勪紶闁告洦鍋€閸嬫捇宕奸弴鐐碉紮闂佸搫绋侀崑鈧柛?
		else sta=SD_ReadMultiBlocks(buf,lsector,512,cnt);//闂傚倸鍊搁崐宄懊归崶褉鏋栭柡鍥ュ灩缁愭鏌熼悧鍫熺凡闁告垹濮撮埞鎴︽偐鐎圭姴顥濈紓浣哄閸ㄥ爼寮婚敐澶婄闁挎繂鎲涢幘缁樼厸闁告侗鍘介幉鍝ョ磼鏉堛劌娴柟宕囧█椤㈡鍩€椤掑嫭鍎嶉柣鎺戠獝or  
	}
	return sta;
}
//闂傚倸鍊风粈渚€骞夐敓鐘茬闁哄稁鍘奸悡妯尖偓骞垮劘閸庨潧顫忕紒妯诲闁兼亽鍎抽妴濠囨⒑閸濄儱校闁告梹鐟ラ锝夊川婵犲嫮鐦堝┑顔斤供閸撴盯顢?
//buf:闂傚倸鍊风粈渚€骞夐敓鐘茬闁哄稁鍘介崑锟犳煃閸濆嫭鍣归柡瀣╃窔閺岀喖骞戦幇闈涙濠碘槅鍋呴敃銏ゅ蓟閺囥垹閱囨繝闈涙祩濡偛顪冮妶鍛闁绘牜鍘ч～蹇涙惞鐟欏嫬纾梺闈涱焾閸庢煡鎮楁ィ鍐╁€甸悷娆忓鐏忣參鎮楀☉鎺撴珖闁逞屽墰閺佹悂宕㈣閸┿垺鎯旈妸銉х杸濡炪倖甯掗ˇ顔炬閿曞倹鈷掗柛灞剧懄缁佺増绻涙径瀣鐎规洑鍗抽獮鍥级閸喖娈ゅ┑鐘垫暩婵敻鎳濋崜褏涓嶆い鏍仦閻撶喖鏌熸潏鍓у埌鐞氭岸姊洪崫鍕櫤闁诡喖鍊垮濠氭晸閻樿尙锛滃┑鈽嗗灥閵嗏偓闁稿鎹囧浠嬵敃閻旇渹澹?
//sector:闂傚倸鍊搁崐宄懊归崶褉鏋栭柡鍥ュ灩缁愭鏌熼悧鍫熺凡闁告垹濮撮埞鎴︽偐鐎圭姴顥濈紓浣哄閸ㄥ爼寮婚敐澶婄闁挎繂鎲涢幘缁樼厸闁告侗鍠楅崐鎰版煛瀹€瀣瘈鐎规洘甯掕灒閻炴稈鈧厖澹曢梺鍝勭▉閸嬧偓闁稿鎸搁～婵嬵敆閸屾簽銊╂⒑閸濆嫯顫﹂柛鏃€鍨块獮鍐閵堝懎绐涙繝鐢靛Т鐎氼亞妲愰弴銏♀拻濞达絿鍎ら崵鈧梺鎼炲灪閻撯€崇暦閺屻儱绠甸柟鐑樼箘閸?
//cnt:闂傚倸鍊搁崐宄懊归崶褉鏋栭柡鍥ュ灩缁愭鏌熼悧鍫熺凡闁告垹濮撮埞鎴︽偐鐎圭姴顥濈紓浣哄閸ㄥ爼寮婚敐澶婄闁挎繂鎲涢幘缁樼厸闁告侗鍠楅崐鎰版煛瀹€瀣瘈鐎规洘甯掕灒閻炴稈鈧厖澹曢梺鍝勭▉閸嬧偓闁稿鎸搁～婵嬵敆閸屾簽銊╂⒑閸濆嫯顫﹂柛鏃€鍨块獮鍐閵堝懎绐涙繝鐢靛Т鐎氼亞妲愰弴銏♀拻濞达絽鎽滅粔鐑樸亜閵夛附宕岀€规洘顨呴～婊堝焵椤掆偓椤曪綁顢曢敃鈧粻濠氭偣閸パ冪骇妞ゃ儲绻堝娲濞戞艾顣哄┑鈽嗗亝椤ㄥ﹪銆?
//闂傚倸鍊搁崐宄懊归崶褉鏋栭柡鍥ュ灩缁愭鏌熼悧鍫熺凡闁告垹濮撮埞鎴︽偐鐎圭姴顥濈紓浣哄閸ㄥ爼寮婚敐澶婄闁挎繂鎲涢幘缁樼厸闁告侗鍠楅崐鎰版煛瀹€瀣瘈鐎规洘甯掕灒閻炴稈鈧厖澹曢梺鍝勭▉閸嬧偓闁稿鎸搁～婵嬵敆閸屾簽銊╂倵?闂傚倸鍊搁崐宄懊归崶褉鏋栭柡鍥ュ灩缁愭鏌熼悧鍫熺凡闁告垹濮撮埞鎴︽偐鐎圭姴顥濈紓浣哄閸ㄥ爼寮婚敐澶婄闁挎繂鎲涢幘缁樼厸闁告侗鍠楅崐鎰版煛瀹€瀣瘈鐎规洘甯掕灒閻炴稈鈧厖澹曢梺鍝勭▉閸嬧偓闁稿鎸搁～婵嬵敆閸屾簽銊╂⒑鐠団€虫灀闁哄懐濞€楠炲﹤顭ㄩ崨顓熺€冲┑鈽嗗灥濡椼劍绔?0,闂傚倸鍊搁崐宄懊归崶褉鏋栭柡鍥ュ灩缁愭鏌熼悧鍫熺凡闁告垹濮撮埞鎴︽偐鐎圭姴顥濈紓浣哄閸ㄥ爼寮婚敐澶婄闁挎繂鎲涢幘缁樼厸闁告侗鍠楅崐鎰版煛瀹€瀣瘈鐎规洘甯掕灒閻炴稈鈧厖澹曢梺鍝勭▉閸嬧偓闁?闂傚倸鍊搁崐宄懊归崶褉鏋栭柡鍥ュ灩缁愭鏌熼悧鍫熺凡闁告垹濮撮埞鎴︽偐鐎圭姴顥濈紓浣哄閸ㄥ爼寮婚敐澶婄闁挎繂鎲涢幘缁樼厸闁告侗鍠楅崐鎰版煛瀹€瀣瘈鐎规洘甯掕灒閻炴稈鈧厖澹曢梺鍝勭▉閸嬧偓闁?闂傚倸鍊搁崐宄懊归崶褉鏋栭柡鍥ュ灩缁愭鏌熼悧鍫熺凡闁告垹濮撮埞鎴︽偐鐎圭姴顥濈紓浣哄閸ㄥ爼寮婚敐澶婄闁挎繂鎲涢幘缁樼厸闁告侗鍠楅崐鎰版煛瀹€瀣瘈鐎规洘甯掕灒閻炴稈鈧厖澹曢梺鍝勭▉閸嬧偓闁稿鎸搁～婵嬵敆閸屾簽銊╂⒑閸濆嫯顫﹂柛鏃€鍨块獮鍐閵堝懎绐涙繝鐢靛Т鐎氼亞妲愰弴銏♀拻濞达絽鎽滅粔鐑樸亜閵夛附宕岀€规洘顨呴～婊堝焵椤掆偓椤?	
u8 SD_WriteDisk(u8*buf,u32 sector,u8 cnt)
{
	u8 sta=SD_OK;
	u8 n;
	long long lsector=sector;
	lsector<<=9;
	if((u32)buf%4!=0)
	{
	 	for(n=0;n<cnt;n++)
		{
			memcpy(SDIO_DATA_BUFFER,buf,512);
		 	sta=SD_WriteBlock(SDIO_DATA_BUFFER,lsector+512*n,512);//闂傚倸鍊搁崐宄懊归崶褉鏋栭柡鍥ュ灩缁愭鏌熼悧鍫熺凡闁告垹濮撮埞鎴︽偐鐎圭姴顥濈紓浣哄閸ㄥ爼寮婚敐澶婄闁挎繂鎲涢幘缁樼厸闁告侗鍠楅崐鎰版煛瀹€瀣瘈鐎规洘甯掕灒閻炴稈鈧厖澹曢梺鍝勭▉閸嬧偓闁稿鎸搁～婵囨綇閳哄倹鐣絜ctor闂傚倸鍊搁崐宄懊归崶褉鏋栭柡鍥ュ灩缁愭鏌熼悧鍫熺凡闁告垹濮撮埞鎴︽偐鐎圭姴顥濈紓浣哄閸ㄦ娊鍩€椤掑倹鍤€閻庢凹鍘奸…鍨潨閳ь剙顕ｉ弻銉ョ濞达絽鍘滈幏娲煟閻樺厖鑸柛鏂跨焸瀵悂骞嬮敂鐣屽幐闁诲函缍嗘禍鍫曟偂閸忕⒈娈介柣鎰皺缁犲鏌熼鐣岀煉闁瑰磭鍋ゆ俊鐑芥晜缁涘鎴烽梻鍌氬€风粈渚€骞栭锕€纾归柛顐ｆ礀绾惧綊鏌″搴′簮闁?
			buf+=512;
		} 
	}else
	{
		if(cnt==1)sta=SD_WriteBlock(buf,lsector,512);    	//闂傚倸鍊搁崐宄懊归崶褉鏋栭柡鍥ュ灩缁愭鏌熼悧鍫熺凡闁告垹濮撮埞鎴︽偐鐎圭姴顥濈紓浣哄閸ㄥ爼寮婚敐澶婄闁挎繂鎲涢幘缁樼厸闁告侗鍠楅崐鎰版煛瀹€瀣瘈鐎规洘甯掕灒閻炴稈鈧厖澹曢梺鍝勭▉閸嬧偓闁稿鎸搁～婵囨綇閳哄倹鐣絜ctor闂傚倸鍊搁崐宄懊归崶褉鏋栭柡鍥ュ灩缁愭鏌熼悧鍫熺凡闁告垹濮撮埞鎴︽偐鐎圭姴顥濈紓浣哄閸ㄦ娊鍩€椤掑倹鍤€閻庢凹鍘奸…鍨潨閳ь剙顕ｉ弻銉ョ濞达絽鍘滈幏娲煟閻樺厖鑸柛鏂跨焸瀵悂骞嬮敂鐣屽幐闁诲函缍嗘禍鍫曟偂閸忕⒈娈介柣鎰皺缁犲鏌熼鐣岀煉闁瑰磭鍋ゆ俊鐑芥晜缁涘鎴烽梻鍌氬€风粈渚€骞栭锕€纾归柛顐ｆ礀绾惧綊鏌″搴′簮闁?
		else sta=SD_WriteMultiBlocks(buf,lsector,512,cnt);	//闂傚倸鍊搁崐宄懊归崶褉鏋栭柡鍥ュ灩缁愭鏌熼悧鍫熺凡闁告垹濮撮埞鎴︽偐鐎圭姴顥濈紓浣哄閸ㄥ爼寮婚敐澶婄闁挎繂鎲涢幘缁樼厸闁告侗鍘介幉鍝ョ磼鏉堛劌娴柟宕囧█椤㈡鍩€椤掑嫭鍎嶉柣鎺戠獝or  
	}
	return sta;
}







